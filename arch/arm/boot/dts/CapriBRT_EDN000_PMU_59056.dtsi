	bcmpmu {
		compatible = "Broadcom,bcmpmu";
		reginit = <4 99>;		 /* len of each entry and # of regs */
		initdata = <
			0 0x09 0x19 0xFF	/* 5 sec debounce and 1 sec delay for PON key HW shutdown */
			0 0x14 0x75 0xFF
			0 0x15 0x02 0x02	/* set PC3_EN */
			0 0xC9 0x30 0xFF
			0 0x30 0xFF 0xFF
			0 0x31 0xFF 0xFF
			0 0x32 0xFF 0xFF
			0 0x33 0xFF 0xFF
			0 0x34 0xFF 0xFF
			0 0x35 0xFF 0xFF
			0 0x36 0xFF 0xFF
			0 0x37 0xFF 0xFF
			0 0x38 0xFF 0xFF
			0 0x39 0xFF 0xFF
			0 0x3A 0xFF 0xFF
			0 0x3B 0xFF 0xFF
			0 0x3C 0xFF 0xFF
			0 0x3D 0xFF 0xFF
			0 0x3E 0xFF 0xFF
			0 0x3F 0xFF 0xFF
			0 0x40 0x38 0x38
			0 0x41 0x00 0x04
			0 0x42 0x04 0x04
			0 0x45 0x0C 0xFF
			0 0x47 0x09 0xFF
			1 0xCC 0x43 0xFF
			1 0xCD 0x7F 0xFF
			1 0xCE 0x3B 0xFF
			1 0xCF 0xF8 0xFF
			1 0xD0 0x09 0xFF
			1 0x47 0xD2 0xFF
			1 0x48 0x98 0xFF
			1 0x49 0xF0 0xFF
			1 0x4A 0x58 0xFF
			1 0x4B 0xC3 0xFF
			0 0x82 0x01 0x3F	/* SDSR-1 PC pin OpMode */
			0 0x83 0x00 0x3F
			0 0x84 0x01 0x3F
			0 0x85 0x00 0x3F
			0 0x86 0x01 0x3F	/* SDSR-2 PC pin OpMode */
			0 0x87 0x00 0x3F
			0 0x88 0x01 0x3F
			0 0x89 0x00 0x3F
			0 0xD0 0x24 0x3F
			0 0x7A 0x01 0xFF	/* IOSR-1 PC pin OpMode */
			0 0x7B 0x01 0xFF
			0 0xC3 0x35 0x3F
			0 0xC4 0x35 0x3F
			0 0x7C 0x01 0xFF	/* IOSR-2 PC pin OpMode */
			0 0x7D 0x01 0xFF
			0 0xC6 0x35 0x3F
			0 0xC7 0x35 0x3F
			0 0x7E 0x01 0x3F	/* CSR PC pin OpMode */
			0 0x7F 0x00 0x3F
			0 0x80 0x12 0x3F
			0 0x81 0x12 0x3F
			0 0xC1 0x00 0x3F
			0 0x8E 0x02 0x3F	 /* VSR PC pin OpMode */
			0 0x8F 0x00 0x3F
			0 0x90 0x02 0x3F
			0 0x91 0x00 0x3F
			0 0xD3 0x00 0x3F
			0 0x8A 0x01 0x3F	/* MSR PC pin OpMode */
			0 0x8B 0x00 0x3F
			0 0x8C 0x09 0x3F
			0 0x8D 0x01 0x3F
			0 0xCA 0x01 0x3F
			0 0x60 0x22 0xFF	/* RFLDO PC pin OpMode */
			0 0x61 0x2A 0xFF
			0 0x96 0x9E 0x38
			0 0x72 0x02 0xFF	/* AUDLDO PC pin OpMode */
			0 0x73 0x02 0xFF
			0 0x9F 0xAF 0x38
			0 0x62 0x01 0xFF	/* CAMLDO1 PC pin OpMode */
			0 0x63 0x01 0xFF
			0 0x97 0xB6 0x38
			0 0x64 0x01 0xFF	/* CAMLDO2 PC pin OpMode */
			0 0x65 0x01 0xFF
			0 0x98 0x9C 0x38
			0 0x76 0x01 0xFF	/* USBLDO PC pin OpMode */
			0 0x77 0x01 0xFF
			0 0xA1 0xB9 0x38
			0 0x78 0xAA 0xFF	/* VIBLDO PC pin OpMode */
			0 0x79 0xAA 0xFF
			0 0xA2 0xAF 0x38
			0 0x6A 0x01 0xFF	/* SDLDO PC pin OpMode */
			0 0x6B 0x01 0xFF
			0 0x9B 0xB4 0x38
			0 0x6E 0x01 0xFF	/* MMCLDO1 PC pin OpMode */
			0 0x6F 0x01 0xFF
			0 0x9D 0x89 0x38
			0 0x70 0x05 0xFF	/* MMCLDO2 PC pin OpMode */
			0 0x71 0x15 0xFF
			0 0x9E 0xB1 0x38
			0 0x6C 0x01 0xFF	/* SDXLDO PC pin OpMode */
			0 0x6D 0x01 0xFF
			0 0x9C 0x8D 0x38
			0 0x74 0xAA 0xFF	/* MICLDO PC pin OpMode */
			0 0x75 0xAA 0xFF
			>;
		cutoff = <3300>;
		fg_slp_curr_ua = <1000>;
		fg_factor = <976>;
		fg_sns_res = <10>;
	};

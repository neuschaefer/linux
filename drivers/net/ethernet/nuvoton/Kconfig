## drivers/net/ethernet/nuvoton/Kconfig
```kconfig
# SPDX-License-Identifier: GPL-2.0-only
#
# Nuvoton network device configuration
#

config NET_VENDOR_NUVOTON
	bool "Nuvoton devices"
	default y
	depends on ARM && ARCH_NPCM
	help
	  If you have a network (Ethernet) card belonging to this class, say Y.

	  Note that the answer to this question doesn't directly affect the
	  kernel: saying N will just cause the configurator to skip all
	  the questions about Nuvoton cards. If you say Y, you will be asked
	  for your specific card in the following questions.

if NET_VENDOR_NUVOTON

config NUVOTON_EMC
	tristate "Nuvoton Ethernet MAC Controller (EMC) support"
	select PHYLIB
	select MII
	help
	  Say Y here if you want to use built-in 100 Mbit Ethernet ports on
	  Nuvoton WPCM/NPCM SoCs

endif # NET_VENDOR_NUVOTON
```

## drivers/net/wireless/rtl8188eu/Kconfig
```kconfig
config RTL8188EU
	tristate "Realtek 8188E USB WiFi"
	depends on USB
	---help---
	  Help message of RTL8188EU

config RTL8188_POWER_ONOFF
	bool "Allow Realtek 8188EU change power"
	depends on RTL8188EU
	---help---
		"Allow Realtek 8188EU chip change power state of its USB bus when loading or unloading"
```

## drivers/opm/Kconfig
```kconfig
menu "OPM Support"

config OPM
	bool "ordered power management support"
	default y if ARCH_MT5391
	default y if ARCH_MT5363
	default y if ARCH_MT5365
	default y if ARCH_MT5395
	help
	  support device power management's suspend and resume operation 
	  to be called according to specified order, not depends on device's 
	  registeration sequence.
	  
endmenu
```

## drivers/power/axp_power/Kconfig
```kconfig
menuconfig AW_AXP
	bool "AXP Power drivers"
	depends on REGULATOR
	default n
	---help---
	  This option allows you to select AXP power driver

if AW_AXP

choice
	prompt "AXP PMU type"
	default AW_AXP20

config AW_AXP18
	bool "AXP18 driver"
	---help---
	  AXP18 driver

config AW_AXP19
	bool "AXP19 driver"
	---help---
	  AXP19 driver

config AW_AXP20
	bool "AXP20 driver"
	---help---
	  AXP20 driver

endchoice

config AXP_CHARGEINIT
	bool "AXP initial charging environment set"
	default y

config AXP_CHGCHANGE
	bool "AXP charging current set when suspend\resume\shutdown"
	default y

if AW_AXP20
choice
	prompt "AXP calculate type:"
	default AW_AXP20_COU

	config AW_AXP20_COU
		bool "COULOMB"
		---help---
			AXP driver for coulomb
	config AW_AXP20_OCV
		bool "OCV"
		---help---
			AXP driver for ocv

endchoice

config AXP_NO_POWEROFF_IF_USB_ON
	bool "Kernel does not do power off if external power is present"
	default n
	---help---
		Kernel does not do power off if external charger is present. 
		The device will be shutdowned if external USB power disappear 
		and will be reseted if power key is pressed.

endif # !AW_AXP20

endif # !AW_AXP
```

## drivers/stm8/Kconfig
```kconfig
menu "STM8 Driver support"

config STM8_DRIVER
	tristate "STM8 device interface"
	default y
	help
	  STM8 is a micro controller developed by ST. STM8 driver are supported here. You will need this for
	  hardware STM8 support.

	  If you want STM8 support, you should say Y here.

	  This STM8 support can also be built as a module.  If so, the module will be called stm8.

config STM8_870E_DRIVER
	tristate "STM8 870E device interface"
	default y
	help
          Outdated STM8 driver, but working for 870E device.

endmenu
```

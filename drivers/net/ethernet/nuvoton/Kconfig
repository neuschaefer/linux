## drivers/usb/mod-musb_qmu/Kconfig
```kconfig
config USB_MTK_MUSB
	depends on (USB || USB_GADGET)
	tristate 'MTK MUSB support'
	help
	 Enable MTK MUSB support

config USB_MTK_MUSB_HOST
	depends on (USB || USB_GADGET)
	select USB_MUSB_HDRC_HCD
	tristate 'MTK MUSB host mode'
	help
	 Enable MTK MUSB host mode 
	 
config USB_MTK_MUSB_PERIPHERAL
	depends on (USB || USB_GADGET)
	select USB_GADGET_MUSB_HDRC
	bool 'MTK MUSB peripheral mode'
	help
	 Enable MTK MUSB peripheral mode 

config USB_MTK_MUSB_DMA
	depends on (USB || USB_GADGET)
	select USB_MUSB_INVENTRA_DMA
	tristate 'MTK MUSB DMA support'
	default y
	help
	 Enable MTK MUSB peripheral mode 

config USB_MTK_MUSB_QMU
	depends on (USB || USB_GADGET)
	tristate 'MTK MUSB QMU support'
	help
	 Enable MTK MUSB QMU support 	 
```

## fs/Kconfig.snsc
```kconfig
comment "SNSC related options"
	depends on SNSC

config SNSC_FS_FLUSH_HARDWARE_CACHE
	bool "Flush hardware cache"
	depends on SNSC
	default y
	help
	  If you want to flush hardware cache after syncing blockdev buffers,
	  say Y.

config SNSC_FS_OSYNC_INODE_ONLY
	bool "Add generic_osync_inode_only()"
	depends on SNSC
	default n
	help

	  Add generic_osync_inode_only() for fs-osync-inode.
	  fs-osync-inode patch called generic_osync_inode().
	  But it was obsoleted. So make new function generic_osync_inode_only().
	  This function has a function that is simpler than generic_osync_inode().

config SNSC_FS_OSYNC_ATTR
	bool "Sync inode when attribute is changed"
	depends on SNSC_FS_OSYNC_INODE_ONLY
	default y
	help
	  This option add sync operation after attribute changed, if
	  sync mount option specified.

config SNSC_FS_IOCTL_SYNC
	bool "Enable ioctl command to sync specified file system"
	depends on SNSC
	default n

config SNSC_FS_CLEAR_MAPPING_ERRORS
	bool "Clear mapping errors when partition is rescaned."
	depends on SNSC
	default n

config SNSC_FS_VFAT_POSIX_ATTR
	bool "VFAT POSIX attribute support"
	depends on SNSC && VFAT_FS
	default n

config SNSC_FS_FAT_LOOKUP_HINT
	bool "Use hint on scanning directories for FAT"
	depends on SNSC && (MSDOS_FS || VFAT_FS)
	default n

config SNSC_FS_VFAT_AVOID_DOUBLE_LINK
	bool "Fix write ordering issue on rename for VFAT"
	depends on SNSC && VFAT_FS
	default n

config SNSC_FS_VFAT_AVOID_DOUBLE_LINK_DEFAULT
	int "Default value of avoiding double link"
	depends on SNSC_FS_VFAT_AVOID_DOUBLE_LINK
	default 1

config SNSC_FS_FAT12_NO_SECTOR_BOUNDARY
	bool "Allocate no new entry which accross sector boundary for FAT12"
	depends on SNSC && (MSDOS_FS || VFAT_FS)
	default n

config SNSC_FS_FAT_UNIX_DATE
	bool "Check and correct invalid date over time_t range for FAT"
	depends on SNSC && (MSDOS_FS || VFAT_FS)
	default n

config SNSC_FS_FAT_RELAX_SYNC
	bool "Loose I/O submission ordering control with 'sync' for FAT"
	depends on SNSC && (MSDOS_FS || VFAT_FS)
	default n
	help
	  This option introduces an new option "relax_sync", works with "sync".
	  This makes I/O submission ordering control loose a little bit.  For
	  instance, with this option, fat permits potential I/O request merge
	  for file allocation table and async file allocation table mirroring.

config SNSC_FS_FAT_GC
	bool "Enable 'gc' option for FAT"
	depends on SNSC && (MSDOS_FS || VFAT_FS)
	default n
	help
	  This option introduces an new option "gc".

config SNSC_FS_FAT_BATCH_SYNC
	bool "Enable 'batch_sync' option for FAT"
	depends on SNSC && (MSDOS_FS || VFAT_FS)
	default n
	help
	  This option introduces an new option "batch_sync".

config SNSC_FS_FAT_FIX_UTF8
	bool "Enable to skip long name over d_name length"
	depends on SNSC && (MSDOS_FS || VFAT_FS)
	default y

config SNSC_FS_ROOT_VFAT
	bool "Root file system on VFAT"
	depends on SNSC_FS_VFAT_POSIX_ATTR
	help
	  If you have enabled VFAT POSIX attribute support, and you want
	  to be able to use the VFAT image as a root file system, say Y.

config SNSC_FS_VFAT_COMPARE_UNICODE
	bool "Enable 'comp_uni' option for VFAT"
	depends on SNSC && VFAT_FS
	default n
	help
	  This option introduces an new option "comp_uni".

config SNSC_FS_FAT_TIMEZONE
	bool "Enable 'timezone' option for FAT"
	depends on SNSC && (MSDOS_FS || VFAT_FS)
	default n
	help
	  This option introduces an new option "timezone".

config SNSC_FS_VFAT_CLEAN_SHUTDOWN_BIT
	bool "Enable 'clnshutbit' option for VFAT"
	depends on SNSC && VFAT_FS
	default n
	help
	  This option introduces an new option "clnshutbit".

config SNSC_FS_VFAT_IGNORE_CRTIME
	bool "Enable 'ignore_crtime' option for VFAT"
	depends on SNSC && VFAT_FS
	default n
	help
	  This option introduces an new option "ignore_crtime".

config SNSC_FS_FAT_STRICT_CHECK_ON_BOOT_SECTOR
	bool "Enables strict check on fat boot sector"
	depends on SNSC && (MSDOS_FS || VFAT_FS)

config SNSC_FS_VFAT_CHECK_DISK
	bool "Enables 'check_disk' option for VFAT"
	depends on SNSC && VFAT_FS && SNSC_BLOCK_K3D

config SNSC_FS_FAT_FLUSH_NO_WAIT_AT_CLOSING_CLEAN_FILES
	bool "Avoid wait at closing clean files"
	depends on SNSC && (MSDOS_FS || VFAT_FS)
	default y
	help
	  Avoid wait at closing clean files when 'flush' option is specified.

config SNSC_FS_FAT_IOCTL_EXPAND_SIZE
	bool "Enable ioctl command to expand file size without filling a gap"
	depends on SNSC && (MSDOS_FS || VFAT_FS)
	default n
```

## fs/nls/Kconfig.snsc
```kconfig
comment "SNSC related options"
	depends on SNSC

config SNSC_FIX_NLS_CODEPAGE_437
	bool "Fix codepage 437 (United States, Canada)"
	depends on SNSC && NLS_CODEPAGE_437
	default y

config SNSC_FIX_NLS_CODEPAGE_850
	bool "Fix Codepage 850 (Europe)"
	depends on SNSC && NLS_CODEPAGE_850
	default y

config SNSC_FIX_NLS_CODEPAGE_932
	bool "Fix japanese charsets (Shift-JIS, EUC-JP)"
	depends on SNSC && NLS_CODEPAGE_932
	default y

config SNSC_FIX_NLS_CODEPAGE_874
	bool "Fix Thai charset (CP874, TIS-620)"
	depends on SNSC && NLS_CODEPAGE_874
	default y

config SNSC_FIX_NLS_CODEPAGE_1251
        bool "Fix Windows CP1251 (Bulgarian, Belarusian)"
        depends on SNSC && NLS_CODEPAGE_1251
        default y

config SNSC_FIX_NLS_ISO8859_1
	bool "Fix NLS ISO 8859-1  (Latin 1; Western European Languages)"
	depends on SNSC && NLS_ISO8859_1
	default y

config SNSC_FIX_NLS_ISO8859_2
	bool "Fix NLS ISO 8859-2  (Latin 2; Slavic/Central European Languages)"
	depends on SNSC && NLS_ISO8859_2
	default y

config SNSC_NLS_CODEPAGE_1252
	tristate "Windows CP1252 (Western European languages)"
	help
	  The Microsoft FAT file system family can deal with filenames in
	  native language character sets. These character sets are stored in
	  so-called DOS codepages. You need to include the appropriate
	  codepage if you want to be able to read/write these filenames on
	  DOS/Windows partitions correctly. This does apply to the filenames
	  only, not to the file contents. You can include several codepages;
	  say Y here if you want to include the DOS codepage for Western
	  European languages.

config SNSC_NLS_CODEPAGE_1253
	tristate "Windows CP1253 (Greek)"
	help
	  The Microsoft FAT file system family can deal with filenames in
	  native language character sets. These character sets are stored in
	  so-called DOS codepages. You need to include the appropriate
	  codepage if you want to be able to read/write these filenames on
	  DOS/Windows partitions correctly. This does apply to the filenames
	  only, not to the file contents. You can include several codepages;
	  say Y here if you want to include the DOS codepage for Greek.

config SNSC_NLS_CODEPAGE_1254
	tristate "Windows CP1254 (Turkish)"
	help
	  The Microsoft FAT file system family can deal with filenames in
	  native language character sets. These character sets are stored in
	  so-called DOS codepages. You need to include the appropriate
	  codepage if you want to be able to read/write these filenames on
	  DOS/Windows partitions correctly. This does apply to the filenames
	  only, not to the file contents. You can include several codepages;
	  say Y here if you want to include the DOS codepage for Turkish.

config SNSC_NLS_CODEPAGE_1256
	tristate "Windows CP1256 (Arabic)"
	help
	  The Microsoft FAT file system family can deal with filenames in
	  native language character sets. These character sets are stored in
	  so-called DOS codepages. You need to include the appropriate
	  codepage if you want to be able to read/write these filenames on
	  DOS/Windows partitions correctly. This does apply to the filenames
	  only, not to the file contents. You can include several codepages;
	  say Y here if you want to include the DOS codepage for Arabic.
```

## net/bluetooth/hidp/Kconfig
```kconfig
config BT_HIDP
	tristate "HIDP protocol support"
	depends on BT && BT_L2CAP && INPUT && HID_SUPPORT
	select HID
	help
	  HIDP (Human Interface Device Protocol) is a transport layer
	  for HID reports.  HIDP is required for the Bluetooth Human
	  Interface Device Profile.

	  Say Y here to compile HIDP support into the kernel or say M to
	  compile it as module (hidp).

config BT_HID_SONY_CTRL
	tristate "BT Sony WirelessController support"
	depends on BT
	---help---
	Support for Sony WirelessController.
```

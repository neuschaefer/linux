sys.cpu arm926ej
sys.jc 8mhz
sys.mode attach

;sys.jc rtck
;wait 10.ms

d.load.elf ./mt5388m1v1_debug_diag.axf /nocode
setup.imaskhll on
setup.imaskasm on
y.spath . 
y.spath.srd ../5387_driver
;y.spath.srd ../demo
;y.spath.srd ../drv_if
;y.spath.srd ../diag
data.list
m
V %HEX
task.config c:\T32\demo\arm\KERNEL\NUCLEUS\nucleus
menu.reprogram c:\T32\demo\arm\KERNEL\NUCLEUS\nucleus




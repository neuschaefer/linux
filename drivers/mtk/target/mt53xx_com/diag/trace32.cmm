
store "breakpts.cmm" Break
; store "windowps.cmm" Win

sys.reset
SYS.CPU ARM926ej

; In General, you can use rtck to select clock automatically.
SYS.JC 8.0MHz
SYS.M UP
wait 10.ms
; Disable MMU
D.S C15:0x1 %LONG 0
D.S SD:0x20005080 %LE %LONG 0
D.S SD:0x2000705c %LE %LONG 0
D.S SD:0x20007064 %LE %LONG 0
D.S SD:0x2000706c %LE %LONG 0
D.S SD:0x20007074 %LE %LONG 0
D.S SD:0x200070c4 %LE %LONG 0
D.S SD:0x20008034 %LE %LONG 0
D.S SD:0x2000804C %LE %LONG 0
D.S SD:0x20028044 %LE %LONG 0

; This is the program name that you want to load
D.LOAD .\mt5388m1v1_debug_diag.axf

do "breakpts.cmm"
; do "windowps.cmm"

setup.imaskhll on
setup.imaskasm on
; You need to set the path of source code, otherwise you could not
; see the source when debugging.
y.spath . 
y.spath.srd ../5387_driver
y.spath.srd ../../../../middleware
data.list
m
V %HEX
task.config C:\T32\demo\arm\KERNEL\NUCLEUS\nucleus
menu.reprogram C:\T32\demo\arm\KERNEL\NUCLEUS\nucleus
; go












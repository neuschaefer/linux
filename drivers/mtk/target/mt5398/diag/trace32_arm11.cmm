
store "breakpts.cmm" Break
; store "windowps.cmm" Win

sys.reset
sYS.CPU ARM1176jzf

; In General, you can use rtck to select clock automatically.
SYS.JC 3.0MHz
SYS.M UP
wait 10.ms
;switch ARM mode
R.S T 0
; Disable MMU
D.S C15:0x1 %LONG 0
D.S SD:0xf0005080 %LE %LONG 0
;disbale L2
;D.S SD:0xf2000100 %LE %LONG 0

; Reset MID begin.
D.S SD:0xf0007470 %LE %LONG 1
D.S SD:0xf0007400 %LE %LONG 0
D.S SD:0xf0007410 %LE %LONG 0
D.S SD:0xf0007420 %LE %LONG 0
D.S SD:0xf0007430 %LE %LONG 0
D.S SD:0xf0007440 %LE %LONG 0
D.S SD:0xf0007470 %LE %LONG 0
; Reset MID end.

;disable interrupt and watchdog
D.S SD:0xf0008034 %LE %LONG 0
D.S SD:0xf000804C %LE %LONG 0
D.S SD:0xf0008084 %LE %LONG 0
D.S SD:0xf0028044 %LE %LONG 0

; This is the program name that you want to load
D.LOAD .\fpga_arm11_debug_diag.axf

do "breakpts.cmm"
; do "windowps.cmm"

setup.imaskhll on
setup.imaskasm on
; You need to set the path of source code, otherwise you could not
; see the source when debugging.
y.spath . 
y.spath.srd ../5398_driver
;y.spath.srd ../../../../middleware
data.list
m
V %HEX
task.config C:\T32\demo\arm\KERNEL\NUCLEUS\nucleus
menu.reprogram C:\T32\demo\arm\KERNEL\NUCLEUS\nucleus
; go
















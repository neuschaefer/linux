
store "breakpts.cmm" Break
; store "windowps.cmm" Win

SYS.RESET

;====select configuration according to your enviroment====
;=========================================================
; CVD, dual core
SYSTEM.CPU CortexA9MPCoreSMP2
SYS.JC 30.0MHz

; CVD, single core
;SYSTEM.CPU CortexA9
;SYS.JC 30.0MHz

;T32 single&dual core
;SYSTEM.CPU CortexA9MPCore
;SYS.JC 15.0MHz
;SYSTEM.MULTICORE COREBASE APB:0x80110000
;=========================================================

SYS.M attach
wait 10.ms


D.LOAD .\common_debug_preloader.axf /nocode

do "breakpts.cmm"
; do "windowps.cmm"

setup.imaskhll on
setup.imaskasm on
; You need to set the path of source code, otherwise you could not
; see the source when debugging.
y.spath . 
y.spath.srd ../5860_preloader
data.list
m
V %HEX
task.config c:\T32\demo\arm\KERNEL\NUCLEUS\nucleus
menu.reprogram c:\T32\demo\arm\KERNEL\NUCLEUS\nucleus
; go







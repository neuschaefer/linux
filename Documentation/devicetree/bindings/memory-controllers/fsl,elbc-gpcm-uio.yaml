## drivers/char/broadcom/Kconfig
```kconfig
#
# Broadcom char driver config
#

menuconfig BRCM_CHAR_DRIVERS
	tristate "Broadcom Char Drivers"
	depends on PROC_FS
	help
	  Broadcom's char drivers

config BRCM_CP_CRASH_DUMP_EMMC
	bool "cp crash dump to eMMC"
	depends on APANIC_ON_MMC
        default y
        ---help---
        Say Y to enable the cp crash dump to eMMC support

config V3D
	tristate "V3D Driver"
	depends on BRCM_CHAR_DRIVERS && (ARCH_RHEA)
	default n

config VCE
	tristate "VCE Driver"
	depends on BRCM_CHAR_DRIVERS && (ARCH_RHEA)
	default n

config BRCM_FUSE_LOG
	tristate "Broadcom FUSE LOG drivers"
	depends on BRCM_CHAR_DRIVERS
	default n
	--help---
	  Broadcom FUSE LOG drivers

config STM_DEFAULT
	tristate "STM Driver"
	depends on BRCM_CHAR_DRIVERS
	default n

config BCM_CPDUMP_INIRQ
	bool "cp crash dump in interrupt"
	depends on BRCM_CHAR_DRIVERS
	default n

config ISP
	tristate "ISP Driver"
	depends on BRCM_CHAR_DRIVERS && (ARCH_RHEA)
	default n

config UNICAM
	tristate "UNICAM Driver"
	depends on BRCM_CHAR_DRIVERS && (ARCH_RHEA)
	default n

config BCMPMU_RPC
	bool "Support rpc with bcmpmu driver"
	depends on BRCM_CHAR_DRIVERS
	depends on MFD_BCMPMU
	depends on SENSORS_BCMPMU
	default n
	---help---
	Select to support PMU ADC info to Modem.

config BCM_AAA
    tristate "Android Amxr Audio ('AAA grade-beef') driver"
    depends on BCM_AMXR && BCM_HALAUDIO && BCM_BSC
    default n
    ---help---
    Select to build the generic AAA driver.

config BCM_BSC
    bool "Board Specific Configuration (BSC) driver support"
    default y
    ---help---
    Say Y to enable the BSC support.

config BCM_GPS_UART
	int "GPS UART"
	depends on BCM_GPS
	--help---
		GPS UART port no e.g. 0,1,2,3 to be used

config BCM_MODEM
        bool "Broadcom Modem Driver"
        depends on BRCM_CHAR_DRIVERS && NET
        default n
        help
          Broadcom Modem IPC drivers

config BCM_MODEM_DEFER_CP_START
        bool "Release CP from reset from main image (deferred)"
        depends on BRCM_CHAR_DRIVERS && NET && BCM_MODEM
        default n
        help
          Causes the main image to release the CP from reset in the case
          where this is not done already from the loader.

config BRCM_FUSE_VSP
	boolean "Broadcom FUSE VSP drivers"
	depends on BRCM_CHAR_DRIVERS && BCM_MODEM
	default n
	help
		Broadcom FUSE VSP drivers for video telephony data transfer

config BCM_IDLE_PROFILER
	bool "Broadcom Idle Profiler Support"
	depends on BRCM_CHAR_DRIVERS && ARCH_KONA
	default n
	help
	  Say y to turn on Broadcom idle profiler support

config BCM_PERFTEST_SUPPORT
    tristate "Broadcom Performance Test (perftest) Support"
    default n
    depends on ARCH_KONA && (ARCH_ISLAND || ARCH_CAPRI)
    help
        Memory copy performance test (sDMA, armlib) on selected cpu

config GPIO_USER_MODE_SUPPORT
	tristate "Broadcom GPIO User Mode Support"
	depends on BRCM_CHAR_DRIVERS
	default n
	help
	  Say y to turn on support for GPIO in user mode

config BCM_HEADSET_SW
   bool "Headset Detection Support"
   depends on BRCM_CHAR_DRIVERS
   default n
   ---help---
   Say Y to enable headset detection.

config BCM_AMXR
   bool "Audio Mixer Driver support"
   depends on BRCM_CHAR_DRIVERS
   default n
   ---help---
   Say Y to enable the Audio Mixer Driver to support interconnecting
   audio samples between kernel objects.

config BCM_AMXR_CORE
   tristate "Audio Mixer Driver support"
   depends on BCM_AMXR
   default n
   ---help---
   Say Y to enable the Audio Mixer Core module.

config BCM_HALAUDIO
    bool "HAL Audio Driver support"
    depends on BRCM_CHAR_DRIVERS
    default n
    help
      Say Y to enable HAL Audio Driver support which is used to control
      audio hardware.

config BCM_HALAUDIO_ALSA
    bool "HAL Audio Driver support"
    depends on SOUND
    depends on BCM_HALAUDIO
    depends on BCM_AMXR
    default y
    help
      Say Y to enable HAL Audio Driver support which is used to control
      audio hardware.

config BCM_HALAUDIO_CORE
    tristate "HAL Audio core framework support"
    depends on BRCM_CHAR_DRIVERS && BCM_HALAUDIO
    default n
    help
      Select m to build HAL Audio core framework module which is used to control
      audio hardware.

config BCM_HALAUDIO_AUDIOH_ISLAND
    tristate "HAL Audio Audio Hub driver for the Island Chip family"
    depends on ARCH_ISLAND
    depends on BRCM_CHAR_DRIVERS
    depends on BCM_HALAUDIO && BCM_AMXR
    depends on MAP_SDMA && MAP_AADMA && MAP_SSASW
    depends on MAP_ISLAND_AUDIOH_CHAL
    default n
    help
      Select m to build the HAL Audio Audio Hub driver.This driver must
      be built as a loadable module otherwise initialization will fail.

config BCM_HALAUDIO_AUDIOH_CAPRI
    tristate "HAL Audio Audio Hub driver for the Capri Chip family"
    depends on ARCH_CAPRI
    depends on BRCM_CHAR_DRIVERS
    depends on BCM_HALAUDIO && BCM_AMXR
    depends on MAP_AADMA && MAP_SSASW
    depends on MAP_AUDIOH_CHAL
    default n
    help
      Select m to build the HAL Audio Audio Hub driver.

config BCM_HALAUDIO_PCM_ISLAND
    tristate "HAL Audio PCM driver for the Island Chip family"
    depends on ARCH_ISLAND
    depends on BRCM_CHAR_DRIVERS
    depends on BCM_HALAUDIO && BCM_AMXR
    depends on MAP_SDMA
    depends on MAP_ISLAND_PCM_CHAL
    default n
    help
      Select m to build the HAL Audio PCM driver.

config BCM_HALAUDIO_PCM_CAPRI
    tristate "HAL Audio PCM driver for the Capri Chip family"
    depends on ARCH_CAPRI
    depends on BRCM_CHAR_DRIVERS
    depends on BCM_HALAUDIO && BCM_AMXR
    depends on MAP_AADMA && MAP_SSASW
    depends on MAP_PCM_CHAL
    default n
    help
      Select m to build the HAL Audio PCM driver.

config BCM_CIR
    tristate "Board Specific Consumer Infra Red (CIR) Driver"
    depends on MAP_CIR_CHAL
    default n
    ---help---
    Say Y to enable the CIR support.

config BCM_VCP
    bool "Video Calling driver support"
    depends on BRCM_CHAR_DRIVERS
    default n
    help
      Say Y to enable VCP driver support which is used to support
      video calling framework.

config BCM_VCPTEST
    tristate "Video Calling driver test"
    depends on BCM_VCP
    default n
    help
      Say Y to enable VCP driver test.

config BCM_GIST
    tristate "Generic I/O Streaming (GIST)"
    default n
    ---help---
    This utility provides low latency non-blocking reads from and writes to files.

config BCM_SIGMORPH
    tristate "Audio Packet Processing"
    default n
    ---help---
    Codec Streaming eXtensions interface to attenuate/mix audio

config BCM_HDMI_DET
    tristate "HDMI detection"
    default n
    ---help---
    Select to build the generic HDMI dectection driver.

config BCM_HDMI_DET_SWITCH
    bool "HDMI detection switch class extension"
    depends on BCM_HDMI_DET
    default n
    ---help---
    Say Y to enable the switch class support in the HDMI detection driver,
    needed for Android HDMI integration.

config BCM_FRAME_PROFILER_SUPPORT
    bool "Enable frame profiling"
    depends on ARCH_BCM116X || ARCH_BCMRING
    default y
    ---help---
      Maintain a history of time spent processing frames.

config BCM_VC_SYSMAN_REMOTE
   tristate "Videocore Remote Sysman Interface"
   default n
   help
          Allows configuration of ARM-accessible registers from videocore

config BCM_WFD
    tristate "WiFi Display Datapath"
    depends on BCM_VC_SERVICES
    default n
    ---help---
    Select to build the generic WiFi Display Datapath driver.

config BCM_OTP
	tristate "OTP Driver"
	depends on ARCH_CAPRI
	default y

config BCM_VC_OMX
	tristate "Videocore OpenMAX"
   depends on BCM_VC_SERVICES
	default n
        help
          Tracker for videocore openmax capabilities, used in integration
          with Android for multimedia support of StageFright.

config BCM_VC_HNFO
	tristate "Videocore HDMI Information"
   depends on BCM_VC_SERVICES
	default n
        help
          Tracker for videocore hdmi capabilities, used in integration
          with Android for multimedia support.

config BCM_VC_DNFO
	tristate "Videocore Display Information"
   depends on BCM_VC_SERVICES
	default n
        help
          Tracker for videocore display capabilities, used in integration
          with Android.

config BCM_VC_LMK
	tristate "Videocore Low-Memory-Killer"
   depends on BCM_VC_SERVICES
	default n
        help
          Helper for low-memory-killer aware of videocore memory comsumption.

config BCM_VC_MEM
	tristate "Videocore Memory"
   depends on BCM_VC_SERVICES
	default n
        help
          Helper for videocore memory access and total size allocation.

config BCM_VC_FB
	tristate "Videocore Frame Buffer"
	depends on FB && BCM_VC_SERVICES
	select FB_CFB_FILLRECT
	select FB_CFB_COPYAREA
	select FB_CFB_IMAGEBLIT
	default n
        help
          Support for the VC framebuffer on the Broadcom reference
          phone. Uses the VCHIQ stack.

config FB_DEFERRED_PAN
	bool "Wait for previous pan operation"
	depends on BCM_VC_FB
	default n
        help
          Enable this if the application choses to wait for vsync after
          each framebuffer update. If set to y, it is recommended that an
          application waits for vsync after each update of the fb. The 
          application can alsao wait for vsync after a multiple of pan
          operations. The max number of operations to wait after,
          is hard to determine. In such case, pan operation may fail.

config BCM_VC_MDEC
	tristate "Videocore media dec driver"
	depends on MACH_CAPRI_ROKU_AUSTIN
	default n
        help
          Support for the VC media decoder on the Broadcom reference
          phone. Uses the VCHIQ stack.

config BCM_VC_SND
	tristate "Videocore alsa driver"
	depends on MACH_CAPRI_ROKU_AUSTIN && SND
    select SND_PCM
	default n
        help
          Support for the VC alsa driver on the Broadcom reference
          phone. Uses the VCHIQ stack.

config BCM_VC_SM
	tristate "VMCS Shared Memory"
   depends on BCM_VC_SERVICES
	default n
        help
          Support for the VC shared memory on the Broadcom reference
          design. Uses the VCHIQ stack.

config BCM_VC_CMA
	tristate "Videocore CMA"
   depends on BCM_VC_SERVICES
	default n
        help
          Helper for videocore CMA access.

config BCM_VC_DISPLAY
	tristate "Broadcom VideoCore display device support"
   depends on BCM_VC_SERVICES
	default n
	help
		LCD & backlight device drivers for the Broadcom VideoCore GPU.

source "drivers/char/broadcom/csx/Kconfig"

config BCM_RTC_CAL
    tristate "RTC CAL"
    depends on BCM_MODEM && MFD_BCM59056 && (ARCH_RHEA || ARCH_CAPRI)
    default n
    ---help---
      Select to build the RTC CAL driver.
```

## drivers/i2c/algos/Kconfig
```kconfig
# Includes Intel Corporation's changes/modifications dated: 2014.
# Changed/modified portions - Copyright © 2014, Intel Corporation.
#
# I2C algorithm drivers configuration
#

menu "I2C Algorithms"
	depends on !I2C_HELPER_AUTO

config I2C_ALGOAVALANCHE
	tristate "I2C TI-Avalanche interfaces"
	depends on ARCH_AVALANCHE && I2C 
	default y
	help
	  Supports the TI I2C Algorithm.

	  This support is also available as a module.  If so, the module 
	  will be called avalanche-i2c-algo.

config I2C_ALGOBIT
	tristate "I2C bit-banging interfaces"

config I2C_ALGOPCF
	tristate "I2C PCF 8584 interfaces"

config I2C_ALGOPCA
	tristate "I2C PCA 9564 interfaces"

endmenu
```

## drivers/misc/vmcs_services/Kconfig
```kconfig
comment "Broadcom vmcs services drivers"

menuconfig BRCM_MISC_DRIVERS
	bool "Broadcom Misc Drivers"
	depends on PROC_FS
	help
	  Broadcom's VideoCore related drivers

config VC_GENCMD
	tristate "GENCMD Driver"
	depends on BRCM_MISC_DRIVERS
	default n
```

## drivers/mrpc/Kconfig
```kconfig
config MRPC
    tristate "RPC over HW Mailbox support"
    depends on HAVE_HW_MBOX
    default y
    help
       Enable RPC over HW mailbox driver support

config MRPC_EXAMPLES
    bool "RPC over HW Mailbox examples"
    depends on MRPC
    default n
    help
       Choose y to compile client/server examples

config MRPC_CLIENT_EXAMPLE
    tristate "RPC over HW Mailbox client example"
    depends on MRPC_EXAMPLES
    default n
    help
       RPC over HW mailbox example client

config MRPC_SERVER_EXAMPLE
    tristate "RPC over HW Mailbox server example"
    depends on MRPC_EXAMPLES
    default n
    help
       RPC over HW mailbox example server

config MRPC_MODPHY_SERVER
    tristate "modphy MRPC server"
    depends on MRPC
    default n
    help
       modphy MRPC server driver support

config MRPC_PP_SERVER
    tristate "Packet Processor MRPC server"
    depends on MRPC
    default n
    help
       Packet Processor MRPC server driver support

config MRPC_WIFI_PROXY_SERVER
    tristate "Wifi Proxy MRPC server"
    depends on MRPC
    default n
    help
       Wifi Proxy MRPC server driver support

config WIFI_PROXY_SUPPORT_MULTI_VAP
    tristate "Support multi VAP"
    depends on MRPC
    default n
    help
       Wifi Proxy MRPC server driver support

config MRPC_HANDSHAKE_SERVER
    tristate "handshake MRPC server"
    depends on MRPC
    default n
    help
       handshake MRPC server driver support

config MRPC_HANDSHAKE_CLIENT
    tristate "handshake MRPC client"
    depends on MRPC
    default n
    help
       handshake MRPC client driver support

config MRPC_CONNTRACK_SERVER
    bool "Conntrack server RPC over HW Mailbox"
    depends on MRPC
    default n
    help
       Choose y to compile conntrack server module

config MRPC_HIL_CMDS_SERVER
    bool "Hil commands handle server over HW Mailbox"
    depends on MRPC
    default n
    help
      Choose y to compile hil cmds server moudle
      
config MRPC_CPPI_CLIENT
    tristate "CPPI MRPC client"
    depends on MRPC
    default n
    help
       CPPI MRPC client provides CPPI related operations that are implemented
       on ARM side over MRPC interface.

config MRPC_CPPI_SERVER
    tristate "cppi MRPC server"
    depends on MRPC
    default n
    help
       cppi MRPC server driver support

config MRPC_SGC_CLIENT
    tristate "Session Group Counter client"
    depends on MRPC
    default n
    help
       Session Group Counter MRPC client driver support

config MRPC_REMOTE_CONFIG_CLIENT
    tristate "Remote Config client"
    depends on MRPC
    default n
    help
       Remote config MRPC client driver support

config MRPC_GPIO_SERVER
    tristate "gpio MRPC server"
    depends on MRPC
    default n
    help
       gpio MRPC server driver support
```

## drivers/net/wireless/bcmdhd/Kconfig
```kconfig
config BCMDHD
	tristate "Broadcom BCM4329,4330,4334,43241 wireless cards support"
	depends on MMC
	---help---
	  This module adds support for wireless adapters based on
	  Broadcom BCM4329/4330/4334/43241 chipset.

	  This driver uses the kernel's wireless extensions subsystem.

	  If you choose to build a module, it'll be called bcmdhd. Say M if
	  unsure.

choice
	prompt "---Enable chip specific options"
	depends on BCMDHD
	---help---
		Enable specific chip.
config BCMDHD_GENERIC_CHIP_SUPPORT
	bool "No chip specific options"
	depends on BCMDHD
	---help---
		Disable any chip specific options.

config BCM4330
	bool "Broadcom BCM4330 support only"
	depends on BCMDHD
	---help---
		Enable any BCM4330 specific options.

config BCM4334
	bool "Broadcom BCM4334 support only"
	depends on BCMDHD
	---help---
		Enable any BCM4334 specific options.

config BCM43241
	bool "Broadcom BCM43241 support only"
	depends on BCMDHD
	---help---
		Enable any BCM43241 specific options.
endchoice

config BROADCOM_WIFI_RESERVED_MEM
	bool "---Use Reserved memory for driver"
	depends on BCMDHD
    ---help---
	Use statically allocated memory for driver.

config BCMDHD_WEXT
	bool "---Enable WEXT support"
	depends on BCMDHD && CFG80211 = n
	select WIRELESS_EXT
	select WEXT_PRIV
	help
	  Enables WEXT support.

config BCMDHD_FW_PATH
	depends on BCMDHD
	string "Firmware path"
	default "/system/vendor/firmware/fw_wifi.bin"
	---help---
	  Path to the firmware file.

config BCMDHD_NVRAM_PATH
	depends on BCMDHD
	string "NVRAM path"
	default "/system/vendor/firmware/fw_wifi_nvram.txt"
	---help---
	  Path to the calibration file.

config BCMDHD_IF_PREFIX
	depends on BCMDHD
	string "Wireless interface prefix"
	default ""
	---help---
	  Name of wireless interface. The default value is "eth%d".
```

## drivers/nfc/Kconfig
```kconfig
#
# Near Field Communication (NFC) devices
#

menuconfig NFC_DEVICES
	bool "Near Field Communication (NFC) devices"
	default n
	---help---
	  You'll have to say Y if your computer contains an NFC device that
	  you want to use under Linux.

	  You can say N here if you don't have any Near Field Communication
	  devices connected to your computer.

if NFC_DEVICES

config PN544_NFC
	tristate "PN544 NFC driver"
	depends on I2C
	select CRC_CCITT
	default n
	---help---
	  Say yes if you want PN544 Near Field Communication driver.
	  This is for i2c connected version. If unsure, say N here.

	  To compile this driver as a module, choose m here. The module will
	  be called pn544.

config BCM2079x_NFC
	bool "Broadcom 2079x NFC Controller Driver"
	depends on I2C
	default y
	help
		Broadcom 2079x Near Field Communication Controller Support.

config NFC_I2C_GPIO
	bool "NFC is connected by I2C over GPIO"
	depends on I2C_GPIO
	default y
	help
		Say yes if NFC is connected through GPIO.
		
endif # NFC_DEVICES
```

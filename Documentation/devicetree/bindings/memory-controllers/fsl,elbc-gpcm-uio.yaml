## Documentation/devicetree/bindings/memory-controllers/fsl,elbc-gpcm-uio.yaml
```yaml
# SPDX-License-Identifier: (GPL-2.0-only OR BSD-2-Clause)
%YAML 1.2
---
$id: http://devicetree.org/schemas/memory-controllers/fsl,elbc-gpcm-uio.yaml#
$schema: http://devicetree.org/meta-schemas/core.yaml#

title: Userspace I/O interface for Freescale eLBC devices

description:
  The Freescale Enhanced Local Bus controller (eLBC) supports flexible access
  to memory devices, through the General-Purpose Chip-select Machine (GPCM).
  The purpose of this binding is to designate devices attached to eLBC/GPMC for
  use by userspace.

maintainers:
  - J. Neuschäfer <j.ne@posteo.net>

properties:
  compatible:
    const: fsl,elbc-gpcm-uio

  reg:
    maxItems: 1

  elbc-gpcm-br:
    description: Base Register (BR) value to set
    $ref: /schemas/types.yaml#/definitions/uint32

  elbc-gpcm-or:
    description: Option Register (OR) value to set
    $ref: /schemas/types.yaml#/definitions/uint32

  interrupts:
    maxItems: 1

  uio_name:
    $ref: /schemas/types.yaml#/definitions/string

required:
  - compatible
  - reg
  - elbc-gpcm-br
  - elbc-gpcm-or

additionalProperties: false

examples:
  - |
    localbus {
        #address-cells = <2>;
        #size-cells = <1>;

        simple-periph@2,0 {
            compatible = "fsl,elbc-gpcm-uio";
            reg = <0x2 0x0 0x10000>;
            elbc-gpcm-br = <0xfd810800>;
            elbc-gpcm-or = <0xffff09f7>;
        };
    };
```

## Documentation/devicetree/bindings/memory-controllers/fsl,elbc.yaml
```yaml
# SPDX-License-Identifier: (GPL-2.0-only OR BSD-2-Clause)
%YAML 1.2
---
$id: http://devicetree.org/schemas/memory-controllers/fsl,elbc.yaml#
$schema: http://devicetree.org/meta-schemas/core.yaml#

title: Freescale Enhanced Local Bus Controller

maintainers:
  - J. Neuschäfer <j.ne@posteo.net>

properties:
  $nodename:
    pattern: "^localbus@[0-9a-f]+$"

  compatible:
    oneOf:
      - items:
          - enum:
              - fsl,mpc8313-elbc
              - fsl,mpc8315-elbc
              - fsl,mpc8377-elbc
              - fsl,mpc8378-elbc
              - fsl,mpc8379-elbc
              - fsl,mpc8536-elbc
              - fsl,mpc8569-elbc
              - fsl,mpc8572-elbc
              - fsl,p1020-elbc
              - fsl,p1021-elbc
              - fsl,p1023-elbc
              - fsl,p2020-elbc
              - fsl,p2041-elbc
              - fsl,p3041-elbc
              - fsl,p4080-elbc
              - fsl,p5020-elbc
              - fsl,p5040-elbc
          - const: fsl,elbc
          - const: simple-bus

      - items:
          - enum:
              - fsl,mpc8247-localbus
              - fsl,mpc8248-localbus
              - fsl,mpc8272-localbus
          - const: fsl,pq2-localbus
          - const: simple-bus

      - items:
          - enum:
              - fsl,mpc8247-localbus
              - fsl,mpc8248-localbus
              - fsl,mpc8360-localbus
          - const: fsl,pq2pro-localbus
          - const: simple-bus

      - items:
          - enum:
              - fsl,mpc8540-localbus
              - fsl,mpc8544-lbc
              - fsl,mpc8544-localbus
              - fsl,mpc8548-lbc
              - fsl,mpc8548-localbus
              - fsl,mpc8560-localbus
              - fsl,mpc8568-localbus
          - const: fsl,pq3-localbus
          - const: simple-bus

  reg:
    maxItems: 1

  interrupts:
    maxItems: 1

  "#address-cells":
    enum: [2, 3]
    description:
      The first cell is the chipselect number, and the remaining cells are the
      offset into the chipselect.

  "#size-cells":
    enum: [1, 2]
    description:
      Either one or two, depending on how large each chipselect can be.

  ranges:
    description:
      Each range corresponds to a single chipselect, and covers the entire
      access window as configured.

patternProperties:
  # format: name@chipselect,address
  "^.*@[0-9a-f]+,[0-9a-f]+$":
    type: object

additionalProperties: false

examples:
  - |
    localbus@f0010100 {
        compatible = "fsl,mpc8272-localbus",
                     "fsl,pq2-localbus",
                     "simple-bus";
        reg = <0xf0010100 0x40>;
        ranges = <0x0 0x0 0xfe000000 0x02000000
                  0x1 0x0 0xf4500000 0x00008000
                  0x2 0x0 0xfd810000 0x00010000>;
        #address-cells = <2>;
        #size-cells = <1>;

        flash@0,0 {
            compatible = "jedec-flash";
            reg = <0x0 0x0 0x2000000>;
            bank-width = <4>;
            device-width = <1>;
        };

        board-control@1,0 {
            reg = <0x1 0x0 0x20>;
            compatible = "fsl,mpc8360mds-bcsr";
        };

        simple-periph@2,0 {
            compatible = "fsl,elbc-gpcm-uio";
            reg = <0x2 0x0 0x10000>;
            elbc-gpcm-br = <0xfd810800>;
            elbc-gpcm-or = <0xffff09f7>;
        };
    };

  - |
    localbus@e0005000 {
        compatible = "fsl,mpc8315-elbc", "fsl,elbc", "simple-bus";
        reg = <0xe0005000 0x1000>;
        ranges = <0x0 0x0 0xfe000000 0x00800000
                  0x1 0x0 0xe0600000 0x00002000
                  0x2 0x0 0xf0000000 0x00020000
                  0x3 0x0 0xfa000000 0x00008000>;
        #address-cells = <2>;
        #size-cells = <1>;
        interrupts = <77 0x8>;

        flash@0,0 {
            compatible = "cfi-flash";
            reg = <0x0 0x0 0x800000>;
            #address-cells = <1>;
            #size-cells = <1>;
            bank-width = <2>;
            device-width = <1>;
        };

        nand@1,0 {
            compatible = "fsl,mpc8315-fcm-nand",
                         "fsl,elbc-fcm-nand";
            reg = <0x1 0x0 0x2000>;
            #address-cells = <1>;
            #size-cells = <1>;
        };
    };
```

## Documentation/devicetree/bindings/mtd/fsl,elbc-fcm-nand.yaml
```yaml
# SPDX-License-Identifier: (GPL-2.0-only OR BSD-2-Clause)
%YAML 1.2
---
$id: http://devicetree.org/schemas/mtd/fsl,elbc-fcm-nand.yaml#
$schema: http://devicetree.org/meta-schemas/core.yaml#

title: NAND flash attached to Freescale eLBC

description:
  The Freescale Enhanced Local Bus controller (eLBC) contains logic to
  interface with NAND flash, called the NAND Flash Control Machine (FCM).
  This binding describes flash attached to an eLBC using the FCM.

maintainers:
  - J. Neuschäfer <j.ne@posteo.net>

allOf:
  - $ref: raw-nand-chip.yaml#

properties:
  compatible:
    oneOf:
      - items:
          - enum:
              - fsl,mpc8313-fcm-nand
              - fsl,mpc8315-fcm-nand
              - fsl,mpc8377-fcm-nand
              - fsl,mpc8378-fcm-nand
              - fsl,mpc8379-fcm-nand
              - fsl,mpc8536-fcm-nand
              - fsl,mpc8569-fcm-nand
              - fsl,mpc8572-fcm-nand
              - fsl,p1020-fcm-nand
              - fsl,p1021-fcm-nand
              - fsl,p1025-fcm-nand
              - fsl,p2020-fcm-nand
          - const: fsl,elbc-fcm-nand
      - const: fsl,elbc-fcm-nand

  reg:
    maxItems: 1

  "#address-cells":
    const: 1

  "#size-cells":
    const: 1

required:
  - compatible
  - reg

unevaluatedProperties: false

examples:
  - |
    localbus {
        #address-cells = <2>;
        #size-cells = <1>;

        nand@1,0 {
            compatible = "fsl,mpc8315-fcm-nand",
                         "fsl,elbc-fcm-nand";
            reg = <0x1 0x0 0x2000>;
        };
    };

...
```

## Documentation/devicetree/bindings/net/wireless/realtek,rtl8188.yaml
```yaml
# SPDX-License-Identifier: (GPL-2.0 OR BSD-2-Clause)
%YAML 1.2
---
$id: http://devicetree.org/schemas/net/wireless/realtek,rtl8188.yaml#
$schema: http://devicetree.org/meta-schemas/core.yaml#

title: Realtek RTL8188 USB WiFi

maintainers:
  - J. Neuschäfer <j.ne@posteo.net>

description:
  The Realtek RTL8188 is a USB-connected 2.4 GHz WiFi module.

allOf:
  - $ref: /schemas/usb/usb-device.yaml#

properties:
  compatible:
    const: usbbda,179

  reg: true

  vdd-supply:
    description:
      Regulator for the 3V3 supply.

required:
  - compatible
  - reg
  - vdd-supply

additionalProperties: false

examples:
  - |
    #include <dt-bindings/gpio/gpio.h>

    usb {
        #address-cells = <1>;
        #size-cells = <0>;

        wifi: wifi@1 {
            compatible = "usbbda,179";
            reg = <1>;
            vdd-supply = <&vcc3v3>;
        };
    };

...
```

## arch/arm/mach-avalanche/Kconfig
```kconfig
menu "Avalanche SoC Common Options"

#
# Configuration options common to all avalanche series processors come here.
#
config ARCH_SUPPORTS_BIG_ENDIAN
        bool
        default y
        help
          Some machines can be configured for either little or big endian
          byte order. These modes require different kernels. Say Y if your
          machine is little endian, N if it's a big endian machine.

config ARM_AVALANCHE_SOC
        bool "Support for ARM based Avalanche Series TI BroadBand Processor(s)"
    select DMA_NONCOHERENT
    select SWAP_IO_SPACE
    select NONCOHERENT_IO
        help
      Select this option if you intend to run on any of the Avalanche Series
      of the BroadBand Processor(s) by TI.
      Selecting Y will further probe the specific SoC type you want to run on.
      If in doubt say Y.

config CPU_FREQUENCY_AVALANCHE
        depends on ARM_AVALANCHE_SOC
        int "Avalanche SoC CPU frequency (MHz)"
        default 400
        help
      Choose the default value here. The correct value will be read from
      the bootloader environment variables.

config ARM_AVALANCHE_TOP_MEM_RESERVED
        depends on ARM_AVALANCHE_SOC
        hex "Amount of memory to be reserved on the top of RAM"
        default 0x0
    range 0x0 0x800000
        help
      Select the amount of RAM you would like to be kept of the control of linux.
      This memory is reserved from the top of RAM


config AVALANCHE_GENERIC_GPIO
        depends on ARM_AVALANCHE_SOC
        bool "Avalanche GPIO support"
        default y
        help
      Choose Y here if you wish to use the Avalanche GPIO facility.
      If unsure, choose Y.

config ARM_AVALANCHE_TIMER16
        depends on ARM_AVALANCHE_SOC
        bool "Avalanche Timer 16 support"
        default y
        help
      Choose Y here if you wish to use the Avalanche Timer 16
      facility. If unsure, choose Y.

config HAVE_HW_MBOX
	bool

choice
        prompt "Kernel compression method"
        depends on ARM_AVALANCHE_SOC
        help
      Select the compression algoritm for compressing your kernel.

config KERNEL_COMPRESS_7ZIP
        bool 'Use 7ZIP to compress the kernel image'
    help
      Compress the kernel using 7ZIP. Compressed kernel can be
      generated by make ram_zimage.

config KERNEL_COMPRESS_GZIP
        bool 'Use GZIP to compress the kernel image'
    help
      Choose Y to compress the kernel using GZIP. Compressed kernel can be
      generated by make ram_zimage.

endchoice

config AVALANCHE_SERIAL_AUTOFLOW
        depends on ARM_AVALANCHE_SOC
        bool "Avalanche Serial autoflow"
        default y
        help
      Choose Y here if you want to enable Auto flow control on Avalanche
      serial device. If unsure choose Y.

config ARM_AVALANCHE_INTC
        def_bool ARM_AVALANCHE_SOC

config AVALANCHE_INTC_PACING
        depends on ARM_AVALANCHE_INTC
        bool "Avalanche Interrupt Pacing Enable"
        default y
        help
      Choose Y here if you wish to use the interrupt pacing feature of the
      Avalanche interrupt controller hardware. If unsure, choose Y.

config AVALANCHE_INTC_LEGACY_SUPPORT
        depends on ARM_AVALANCHE_INTC
    bool "Avalanche interrupt type and level setting"
        default y
        help
      Choose Y here if you wish to have the ability to set the interrupt
          type (level or edge triggered) and Level active low or high in avalanche
          interrupt controller hardware. If unsure, choose Y.

config AVALANCHE_INTC_ALL_FAST_INTERRUPTS
        depends on AVALANCHE_INTC_DISPATCH_ISR_USING_DO_IRQ = 'n'
        bool "Assume all Avalanche interrupts as 'Fast'"
        default n
        help
      This option ignores the SA_INTERRUPT flag provided with request_irq
      and locks out all the interrupts on the system whenever any
      interrupt is being serviced. This will decrease the time taken
      for ISR to be invoked. Not recommended if any of the interrupts in your
      system is expected to take a long time to execute.
      If unsure, say N.

config CACHE_TESTS
	bool "Enable compilation of cache tests module"
    default n
    help
      Enable compilation of cache tests module

#
# Get to know which specific SoC type the user wants to compile for.
#
choice
        prompt "Intel BroadBand SOC Type (Avalanche Series)"
        depends on ARM_AVALANCHE_SOC
        help
      Select the Intel BoardBand SoC Type that you want the kernel port for. If
      unsure, contact your software vendor.

config MACH_PUMA5
        bool "Puma5 SOC"

config MACH_PUMA6
        bool "Puma6 SOC"

config MACH_PUMA7
        bool "Puma7 SOC"
        select MIGHT_HAVE_CACHE_L2X0
	select HAVE_HW_MBOX

endchoice

config ARM_AVALANCHE_PDSP
	tristate "PDSP General Driver"
	default y
	help
	    Add support for PDSP General Driver.


config HW_MUTEXES
        tristate "HW-MUTEX controller support for Puma platforms (puma6 and newer)"
        depends on MACH_PUMA7 || MACH_PUMA6
        default y
         ---help---
          This is the HW-MUTEX controller support for Intel Puma platforms (puma6 and newer).

choice
        depends on HW_MUTEXES
        prompt "HW-MUTEX controller support for Intel Puma platforms (puma6 and newer)"
        default MUTEX_FIFO
        help
        Allows the configuration of the HW-MUTEX controller working mode in Intel CE platform

       config MUTEX_FIFO
                bool "FIFO scheduler"
       help
        Mutex works in FIFO scheduler mode, which is the default behaviour

       config  MUTEX_NULL
                bool "Null scheduler"
        help
        Mutex works in Null scheduler mode

       config MUTEX_POLLING
                bool "Polling mode"
       help
         works in polling mode, interrupt is disabled

endchoice


if MACH_PUMA5 = 'y'
    source "arch/arm/mach-avalanche/ti_puma5/Kconfig"
endif

if MACH_PUMA6 = 'y'
    source "arch/arm/mach-avalanche/puma6/Kconfig"
endif

if MACH_PUMA7 = 'y'
    source "arch/arm/mach-avalanche/puma7/Kconfig"

#
# PAL CPPI4.1 HW Mailbox support
#
config CPPI4_HW_MBOX_SUPPORT
	bool "CPPI4.1 HW Mailbox support"
	default y
	---help---
	  If accessing CPPI API's via mailbox is needed
	  then select yes, otherwise select no.
endif

endmenu

#
# Select some configuration options automatically based on user selections.
#

config  DMA_NONCOHERENT
        bool

config SWAP_IO_SPACE
        bool

config NONCOHERENT_IO
        bool
```

## arch/arm/mach-avalanche/puma6/Kconfig
```kconfig
menu "Puma6 Configuration"
    depends on MACH_PUMA6 = 'y'

#
# All the configuration options specific to a particular SoC come here.
#

# Get to know the reference board the user wants to compile for
choice
    prompt "Puma6 reference board type"
    help
      Select the Puma6 Ref. Design Board that you are using. If you are not
      using any of these, choose the one closest to your design and make
      modifications to the kernel as required.

config MACH_PUMA6_FPGA
    bool "Puma6 FPGA Board"

config MACH_PUMA6_BOARD
    bool "Puma6 Board"

endchoice

menu "Puma6 Memory Configuration"

config ARM_AVALANCHE_SDRAM_PHYS_ADDRESS
    hex "ARM physical start address of SDRAM"
    default 0x40000000
    help
        ARM start address in SDRAM.
        For Puma6 it must be 0x40000000.

config ARM_AVALANCHE_SDRAM_PHYS_OFFSET
    hex "ARM Kernel start offset in SDRAM"
    default 0x00000000
    help
        ARM start address in SDRAM.
        For Puma6 it must be 0x40000000.

config ARM_AVALANCHE_KERNEL_ZRELADDR_OFFSET
    hex "ARM Kernel ZRELADDR start offset in kernel space"
    default 0x00018000
    help
        ARM Kernel ZRELADDR start offset from the beginning of the Kernel address space.
        For Puma6 it must be 0x18000

config ARM_AVALANCHE_KERNEL_INITRD_OFFSET
    hex "ARM Kernel INITRD start offset in kernel space"
    default 0x00400000
    help
        ARM Kernel INITRD start offset from the beginning of the Kernel address space.
        For Puma6 it must be 0x00400000

config ARM_AVALANCHE_KERNEL_PARAMS_OFFSET
    hex "ARM Kernel PARAMS start offset in kernel space"
    default 0x00000100
    help
        ARM Kernel PARAMS start offset from the beginning of the Kernel address space.
        For Puma6 it must be 0x100

config ARM_AVALANCHE_SDRAM_ADDRESS
    hex "(recalculated) ARM Kernel start address in SDRAM"
    default 0x40000000
    help
        ARM start address in SDRAM.
        For Puma6 it must be 0x40000000 + ARM_AVALANCHE_SDRAM_PHYS_OFFSET (offset that the ARM and ATOM should agree on).
        This value is going to be recalculated by the external script

config ARM_AVALANCHE_KERNEL_ZRELADDR_ADDRESS
    hex "(recalculated) ARM Kernel ZRELADDR start address in SDRAM"
    default 0x40018000
    help
        ARM Kernel ZRELADDR start address in SDRAM.
        For Puma6 it must be ARM_AVALANCHE_SDRAM_ADDRESS + 0x18000
        This value is going to be recalculated by the external script

config ARM_AVALANCHE_KERNEL_INITRD_ADDRESS
    hex "(recalculated) ARM Kernel INITRD start address in SDRAM"
    default 0x40400000
    help
        ARM Kernel INITRD start address in SDRAM.
        For Puma6 it must be ARM_AVALANCHE_SDRAM_ADDRESS +  0x400000
        This value is going to be recalculated by the external script

config ARM_AVALANCHE_KERNEL_PARAMS_ADDRESS
    hex "(recalculated) ARM Kernel PARAMS start address in SDRAM"
    default 0x40000100
    help
        ARM Kernel PARAMS start address in SDRAM.
        For Puma6 it must be ARM_AVALANCHE_SDRAM_ADDRESS + 0x100
        This value is going to be recalculated by the external script

endmenu


config AVALANCHE_U_BOOT
        bool "Avalanche U-Boot support"
        default y
        help
          Choose y to build and use U-Boot bootloader.

config ARM_AVALANCHE_SPI
        bool "Avalanche SPI support"
        depends on SPI
        default y
        help
          Choose y to compile the Avalanche SPI driver.

config ARM_AVALANCHE_MMC
        bool "Avalanche eMMC support"
        default y
        help
          Choose y to compile the Avalanche eMMC driver.


config PSP_TRACE
        bool "PSP trace support"
        default n
        help
          choose y to compile psp trace support

config ARM_CPMAC_DS_TRAFFIC_PRIORITY
        bool "Downstream Traffic Priority support"
        default y
        select TI_META_DATA
    help
          choose y enable Downstream Traffic Priority support

config ARM_AVALANCHE_PPD
    tristate "DOCSIS Packet Processor Driver"
    default y
    help
        Choose y to compile in the packet processor driver for packet processing acceleration.

config ARM_AVALANCHE_PDSP_PP
	tristate "Packet Processor Driver"
	depends on ARM_AVALANCHE_PDSP
	default y
	help
	    Add support for Packet Processor Driver.

config IOSFSB_DRV
        tristate "IOSF sideband support for Puma6 platform"
        depends on MACH_PUMA6
        default y
         ---help---
          This is the IOSF sideband driver for Intel Puma6 platform.

config P_UNIT_DRV
        tristate "Power Control Unit support for Puma6 platform"
        depends on MACH_PUMA6
        default y
         ---help---
          The Power Control Unit driver for Intel Puma6 platform.

config ARM_AVALANCHE_PPD_TEST
    bool "Packet Processor Test"
    depends on ARM_AVALANCHE_PPD
    default y
    help
        Choose y to compile in the test support for packet processor driver.

config CAT_L2SWITCH_NID
        bool "L2Switch Network Interface Devices Support"
    default y
    help
        Choose y to compile the L2Switch NID driver.


config AVALANCHE_NUM_SER_PORTS
    depends on ARM_AVALANCHE_SOC
    int "Number of serial ports"
    default 2
    help
      Choose the correct number of serial ports on your soc here. If unsure
      consult the SoC specification from your vendor, but do not put a
      wrong value here.

config AVALANCHE_CONSOLE_PORT
    depends on ARM_AVALANCHE_SOC
    int "Port number of the console"
    default 0
    help
      Choose the Avalanche serial port number functioning as the ttyS0 (console)
      port. The valid values range from 0 through AVALANCHE_NUM_SER_PORTS - 1.

config ARM_AVALANCHE_COLORED_LED
    bool "COLOR LED support"
    default y
    help
      Choose Y, to compile the LED support.

config CABLE_VFE_COE
        bool "Enable Coe for FCC support"
    default n
    help
      Enable COE engine for Fast Channel Change (FCC) support
      
config WIFI_MESH_TUNNEL
	depends on ARM_AVALANCHE_PDSP_PP
        bool "Enable WiFi-Mesh tunnel support"
    default n
    help
      Enable Kernel configuration to support WiFi Mesh feature in PP 

config WIFI_MESH_DEBUG
	depends on WIFI_MESH_TUNNEL
        bool "Enable WiFi-Mesh debug"
    default n
    help
      Enable debug for WiFi-Mesh feature

config WIFI_MESH_DEBUG_TEST
	depends on WIFI_MESH_DEBUG
        bool "Enable WiFi-Mesh test"
    default n
    help
      Enable test WiFi-Mesh feature
      
endmenu
```

## arch/arm/mach-avalanche/puma7/Kconfig
```kconfig
menu "Puma7 Configuration"
    depends on MACH_PUMA7 = 'y'

#
# All the configuration options specific to a particular SoC come here.
#

# Get to know the reference board the user wants to compile for
choice
    prompt "Puma7 reference board type"
    help
      Select the Puma7 Ref. Design Board that you are using. If you are not
      using any of these, choose the one closest to your design and make
      modifications to the kernel as required.

config MACH_PUMA7_FPGA
    bool "Puma7 FPGA Board"

config MACH_PUMA7_BOARD
    bool "Puma7 Board"

endchoice

config MACH_PUMA7_FPGA_X1_CLK_FREQ_HZ
    int "NetIP x1 clock frequency in Hz"
    default 7500000
    depends on MACH_PUMA7_FPGA
    help
     NetIP x1 clock frequency in Hz.

config MACH_PUMA7_FPGA_PP
        bool "Puma7 FPGA PP"
        default y
		depends on MACH_PUMA7_FPGA
        help
          Choose y to build and use PUMA7 PP CPPI for FPGA.

config MACH_PUMA7_FPGA_DS
        bool "Puma7 FPGA DS"
        default y
		depends on MACH_PUMA7_FPGA
        help
          Choose y to build and use PUMA7 DS CPPI for FPGA.

config MACH_PUMA7_FPGA_US
        bool "Puma7 FPGA US"
        default n
		depends on MACH_PUMA7_FPGA
        help
          Choose y to build and use PUMA7 US CPPI for FPGA.


menu "Puma7 Memory Configuration"

config ARM_AVALANCHE_SDRAM_PHYS_ADDRESS
    hex "ARM physical start address of SDRAM"
    default 0x00000000
    help
        ARM start address in SDRAM.
        For Puma7 it must be 0x40000000.

config ARM_AVALANCHE_SDRAM_PHYS_OFFSET
    hex "ARM Kernel start offset in SDRAM"
    default 0x00000000
    help
        ARM start address in SDRAM.
        For Puma7 it must be 0x40000000.

config ARM_AVALANCHE_KERNEL_ZRELADDR_OFFSET
    hex "ARM Kernel ZRELADDR start offset in kernel space"
    default 0x00018000
    help
        ARM Kernel ZRELADDR start offset from the beginning of the Kernel address space.
        For Puma7 it must be 0x18000

config ARM_AVALANCHE_KERNEL_INITRD_OFFSET
    hex "ARM Kernel INITRD start offset in kernel space"
    default 0x00400000
    help
        ARM Kernel INITRD start offset from the beginning of the Kernel address space.
        For Puma7 it must be 0x00400000

config ARM_AVALANCHE_KERNEL_PARAMS_OFFSET
    hex "ARM Kernel PARAMS start offset in kernel space"
    default 0x00000100
    help
        ARM Kernel PARAMS start offset from the beginning of the Kernel address space.
        For Puma7 it must be 0x100

config ARM_AVALANCHE_SDRAM_ADDRESS
    hex "(recalculated) ARM Kernel start address in SDRAM"
    default 0x40000000
    help
        ARM start address in SDRAM.
        For Puma7 it must be 0x40000000 + ARM_AVALANCHE_SDRAM_PHYS_OFFSET (offset that the ARM and ATOM should agree on).
        This value is going to be recalculated by the external script

config ARM_AVALANCHE_KERNEL_ZRELADDR_ADDRESS
    hex "(recalculated) ARM Kernel ZRELADDR start address in SDRAM"
    default 0x40018000
    help
        ARM Kernel ZRELADDR start address in SDRAM.
        For Puma7 it must be ARM_AVALANCHE_SDRAM_ADDRESS + 0x18000
        This value is going to be recalculated by the external script

config ARM_AVALANCHE_KERNEL_INITRD_ADDRESS
    hex "(recalculated) ARM Kernel INITRD start address in SDRAM"
    default 0x40400000
    help
        ARM Kernel INITRD start address in SDRAM.
        For Puma7 it must be ARM_AVALANCHE_SDRAM_ADDRESS +  0x400000
        This value is going to be recalculated by the external script

config ARM_AVALANCHE_KERNEL_PARAMS_ADDRESS
    hex "(recalculated) ARM Kernel PARAMS start address in SDRAM"
    default 0x40000100
    help
        ARM Kernel PARAMS start address in SDRAM.
        For Puma7 it must be ARM_AVALANCHE_SDRAM_ADDRESS + 0x100
        This value is going to be recalculated by the external script

endmenu


config AVALANCHE_U_BOOT
        bool "Avalanche U-Boot support"
        default y
        help
          Choose y to build and use U-Boot bootloader.

config ARM_AVALANCHE_SPI
        bool "Avalanche SPI support"
        depends on SPI
        default y
        help
          Choose y to compile the Avalanche SPI driver.

config AVALANCHE_PUMA7_SPI_MASTER
       depends on MACH_PUMA7
       bool "Build Puma7 SPI MASTER"
       default y
       help
          Choose y to compile the Avalanche SPI MASTER driver (used for tuner control).

config ARM_AVALANCHE_MMC
        bool "Avalanche eMMC support"
        default y
        help
          Choose y to compile the Avalanche eMMC driver.


config PSP_TRACE
        bool "PSP trace support"
        default n
        help
          choose y to compile psp trace support

config ARM_CPMAC_DS_TRAFFIC_PRIORITY
        bool "Downstream Traffic Priority support"
        default y
        select TI_META_DATA
    help
          choose y enable Downstream Traffic Priority support

config ARM_AVALANCHE_PPD
    tristate "DOCSIS Packet Processor Driver"
    default y
    help
        Choose y to compile in the packet processor driver for packet processing acceleration.

config ARM_AVALANCHE_PDSP_PP
	tristate "Packet Processor Driver"
	depends on ARM_AVALANCHE_PDSP
	default y
	help
	    Add support for Packet Processor Driver.

config IOSFSB_DRV
        tristate "IOSF sideband support for Puma7 platform"
        depends on MACH_PUMA7
        default y
         ---help---
          This is the IOSF sideband driver for Intel Puma7 platform.

config ARM_AVALANCHE_PPD_TEST
    bool "Packet Processor Test"
    depends on ARM_AVALANCHE_PPD
    default y
    help
        Choose y to compile in the test support for packet processor driver.

config AVALANCHE_NUM_SER_PORTS
    depends on ARM_AVALANCHE_SOC
    int "Number of serial ports"
    default 2
    help
      Choose the correct number of serial ports on your soc here. If unsure
      consult the SoC specification from your vendor, but do not put a
      wrong value here.

config AVALANCHE_CONSOLE_PORT
    depends on ARM_AVALANCHE_SOC
    int "Port number of the console"
    default 0
    help
      Choose the Avalanche serial port number functioning as the ttyS0 (console)
      port. The valid values range from 0 through AVALANCHE_NUM_SER_PORTS - 1.

config ARM_AVALANCHE_COLORED_LED
    bool "COLOR LED support"
    default y
    help
      Choose Y, to compile the LED support.

config CABLE_VFE_COE
        bool "Enable Coe for FCC support"
    default n
    help
      Enable COE engine for Fast Channel Change (FCC) support

#
# WIFI Proxy network device driver configuration
#

config WIFI_PROXY
        bool "WIFI proxy network device driver"
        default n
        ---help---
          If PP to WIFI devices communication is needed
          then select yes.
          else, select no.

config WIFI_PROXY_DEBUG
        bool "Enable WiFi proxy FW debugging"
        default n
        depends on WIFI_PROXY
        ---help---
          Enable WiFi proxy FW debugging

config WIFI_PROXY_DEBUG_BUFF_SIZE
        int "Debug buffer size, number of debuf messages"
        default 256
        depends on WIFI_PROXY_DEBUG
        ---help---
          Configure extra shared memory for debugging, default 2MB for PUMA6_SOC, 512KB for PUMA5_SOC

config WIFI_PROXY_EMULATOR
        tristate "WIFI proxy emulator"
        default m
        depends on WIFI_PROXY_DEBUG
        ---help---
          If wifi proxy emulator is needed
          then select yes.
          else, select no.

#
# Crypto PDSP / IPSec support
#

config IPSEC_SUPPORT
       bool "Enable IPSec"
       default n
       ---help---
         Select if IPSec support is needed

config MLOCK_APPS
	bool "mlock all started elf's text sections"
	default y
	help
	  Lock memory for application during elf_load. Lock memory in child process after fork.

endmenu
```

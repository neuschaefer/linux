## arch/arm/plat-mt53xx/Kconfig
```kconfig
# arch/arm/plat-mt53xx/Kconfig
#
# by lh.hsiao
#
# Licensed under GPLv2


if PLAT_MT53XX
# boot configurations
choice
	prompt "ARCH/MACH select"
default MACH_MT5396_FPGA

####################################################
#legancy ARCH 1-to-1 mapping to MACH
#
config ARCH_MT5391
	bool "MediaTek MT5391"
	help
	  This enables support for MediaTek MT5391.

config ARCH_MT5363
	bool "MediaTek MT5363"
	help
	  This enables support for MediaTek MT5363.

config ARCH_MT5365
	bool "MediaTek MT5365"
	select ARCH_USES_GETTIMEOFFSET
	select CPU_V6
	select CPU_32v6K
	help
	  This enables support for MediaTek MT5365.

config ARCH_MT5395
	bool "MediaTek MT5395"
	select ARCH_USES_GETTIMEOFFSET
	select CPU_V6
	select CPU_32v6K
	select CACHE_L2X0
	select CACHE_PL310
	help
	  This enables support for MediaTek MT5395.
	  
#
#end  of legancy
#####################################################
config MACH_MT5368
	bool "MediaTek MT5368(Cortex-A9 single-core)"
	select CPU_V7
	select ARM_GIC
	select ARCH_MT5368
	help
	  This enables support for MediaTek MT5368.

config MACH_MT5396
	bool "MediaTek MT5396(Cortex-A9 dual-core)"
	select CPU_V7
	select SMP 
	select ARM_GIC
	select ARCH_MT5396
	help
	  This enables support for MediaTek MT5396.

config MACH_MT5369
	bool "MediaTek MT5369(Cortex-A9 single-core)"
	select CPU_V7
	select ARM_GIC
	select ARCH_MT5396	       	# Share code with MT5396
	select MT53XX_UP_CHECK
	help
	  This enables support for MediaTek MT5369.

config MACH_MT5389
	bool "MediaTek MT5389(Arm11)"
	select CPU_V6
	select CPU_32v6K
	select ARCH_MT5389
	select CACHE_L2X0
	select CACHE_PL310
	help
	  This enables support for MediaTek MT5389.

config MACH_MT5368_FPGA
	bool "MediaTek MT5368_FPGA(ARM11)"
	select CPU_V6
	select ARCH_MT5368
	select MT53_FPGA
	help
	  This enables support for MediaTek MT5368.

config MACH_MT5396_FPGA
	bool "MediaTek MT5396_FPGA(ARM11)"
	select CPU_V7
	select ARCH_MT5396
	select MT53_FPGA
	help
	  This enables support for MediaTek MT5396.
endchoice  

config ARCH_MT5368
	bool "MediaTek MT5368" if MACH_MT5368 || MACH_MT5368_FPGA
	default n
	select GENERIC_TIME
	select GENERIC_CLOCKEVENTS
	help
	  This enables support for MediaTek MT5368.

config ARCH_MT5396
	bool "MediaTek MT5396" if MACH_MT5396 || MACH_MT5396_FPGA
	default n
	select GENERIC_TIME
	select GENERIC_CLOCKEVENTS
	#select ARCH_USES_GETTIMEOFFSET
	help
	  This enables support for MediaTek MT5396.

config ARCH_MT5389
	bool "MediaTek MT5389" if MACH_MT5389
	default n
	select GENERIC_TIME
	select GENERIC_CLOCKEVENTS
	help
	  This enables support for MediaTek MT5389.

config MT53_FPGA
	bool "FPGA environment"
	default n

config MT53XX_UP_CHECK
	bool
	default n

config MT53XX_USE_CHANNELB_DRAM
	bool "Map channel B DRAM as Linux kernel memory"
	depends on ARCH_MT5396
	default n
	select HIGHMEM
	select ZONE_DMA
	help
	  Map unused channel B DRAM for Linux kernel usage.

endif
```

## arch/mips/configs/montage_defconfig
```kconfig
CONFIG_KERNEL_ZSTD=y
CONFIG_SYSVIPC=y
CONFIG_NO_HZ_IDLE=y
CONFIG_BPF_SYSCALL=y
CONFIG_IKCONFIG=y
CONFIG_IKCONFIG_PROC=y
CONFIG_CC_OPTIMIZE_FOR_SIZE=y
CONFIG_LD_DEAD_CODE_DATA_ELIMINATION=y
CONFIG_EMBEDDED=y
CONFIG_CPU_LITTLE_ENDIAN=y
CONFIG_CPU_MIPS32_R2=y
CONFIG_MIPS_CPS=y
CONFIG_HIGHMEM=y
CONFIG_NR_CPUS=16
CONFIG_KEXEC=y
CONFIG_MIPS_O32_FP64_SUPPORT=y
CONFIG_MIPS_RAW_APPENDED_DTB=y
CONFIG_JUMP_LABEL=y
CONFIG_MODULES=y
CONFIG_MODULE_UNLOAD=y
CONFIG_TRIM_UNUSED_KSYMS=y
# CONFIG_COREDUMP is not set
# CONFIG_COMPAT_BRK is not set
CONFIG_USERFAULTFD=y
CONFIG_DEVTMPFS=y
CONFIG_DEVTMPFS_MOUNT=y
CONFIG_BLK_DEV_LOOP=y
CONFIG_SRAM=y
CONFIG_SCSI=y
# CONFIG_SCSI_PROC_FS is not set
CONFIG_BLK_DEV_SD=y
# CONFIG_BLK_DEV_BSG is not set
# CONFIG_SCSI_LOWLEVEL is not set
CONFIG_INPUT_EVDEV=y
CONFIG_SERIAL_8250=y
CONFIG_SERIAL_8250_CONSOLE=y
CONFIG_SERIAL_8250_DW=y
CONFIG_SERIAL_OF_PLATFORM=y
CONFIG_VIRTIO_CONSOLE=y
CONFIG_HW_RANDOM=y
CONFIG_PINCTRL=y
CONFIG_GPIOLIB=y
CONFIG_GPIO_SYSFS=y
CONFIG_GPIO_GENERIC_PLATFORM=y
CONFIG_GPIO_XILINX=y
# CONFIG_HWMON is not set
CONFIG_FB=y
# CONFIG_VGA_CONSOLE is not set
CONFIG_FRAMEBUFFER_CONSOLE=y
CONFIG_LOGO=y
CONFIG_HID_A4TECH=y
CONFIG_HID_APPLE=y
CONFIG_HID_BELKIN=y
CONFIG_HID_CHERRY=y
CONFIG_HID_CHICONY=y
CONFIG_HID_CYPRESS=y
CONFIG_HID_EZKEY=y
CONFIG_HID_KENSINGTON=y
CONFIG_HID_LOGITECH=y
CONFIG_HID_MICROSOFT=y
CONFIG_HID_MONTEREY=y
CONFIG_USB=y
CONFIG_USB_EHCI_HCD=y
CONFIG_USB_STORAGE=y
CONFIG_NEW_LEDS=y
CONFIG_LEDS_CLASS=y
CONFIG_LEDS_SYSCON=y
# CONFIG_VIRTIO_MENU is not set
# CONFIG_VHOST_MENU is not set
# CONFIG_MIPS_PLATFORM_DEVICES is not set
CONFIG_COMMON_CLK_BOSTON=y
CONFIG_COMMON_CLK_PISTACHIO=y
CONFIG_CLKSRC_PISTACHIO=y
# CONFIG_IOMMU_SUPPORT is not set
CONFIG_RESET_CONTROLLER=y
CONFIG_RESET_PISTACHIO=y
CONFIG_PHY_PISTACHIO_USB=y
# CONFIG_FILE_LOCKING is not set
CONFIG_FANOTIFY=y
CONFIG_FUSE_FS=y
CONFIG_CUSE=y
CONFIG_OVERLAY_FS=y
CONFIG_VFAT_FS=y
CONFIG_FAT_DEFAULT_UTF8=y
CONFIG_TMPFS=y
CONFIG_TMPFS_POSIX_ACL=y
# CONFIG_MISC_FILESYSTEMS is not set
CONFIG_KEYS=y
CONFIG_CRC16=y
CONFIG_CRC_ITU_T=y
CONFIG_CRC7=y
CONFIG_XZ_DEC=y
# CONFIG_XZ_DEC_X86 is not set
# CONFIG_XZ_DEC_POWERPC is not set
# CONFIG_XZ_DEC_IA64 is not set
# CONFIG_XZ_DEC_ARM is not set
# CONFIG_XZ_DEC_ARMTHUMB is not set
# CONFIG_XZ_DEC_SPARC is not set
CONFIG_PRINTK_TIME=y
# CONFIG_DEBUG_MISC is not set
CONFIG_DEBUG_INFO_DWARF_TOOLCHAIN_DEFAULT=y
CONFIG_DEBUG_INFO_REDUCED=y
CONFIG_MAGIC_SYSRQ=y
CONFIG_DEBUG_FS=y
# CONFIG_SLUB_DEBUG is not set
CONFIG_PANIC_ON_OOPS=y
# CONFIG_SCHED_DEBUG is not set
# CONFIG_FTRACE is not set
CONFIG_CMDLINE_BOOL=y
CONFIG_CMDLINE="earlycon"
```

## drivers/clk/nuvoton/Kconfig
```kconfig
# SPDX-License-Identifier: GPL-2.0
# common clock support for Nuvoton SoC family.

config COMMON_CLK_NUVOTON
	bool "Nuvoton clock controller common support"
	depends on ARCH_MA35 || ARCH_NPCM || COMPILE_TEST
	default y
	help
	  Say y here to enable common clock controller for Nuvoton platforms.

if COMMON_CLK_NUVOTON

config CLK_MA35D1
	bool "Nuvoton MA35D1 clock controller support"
	default y
	help
	  Build the clock controller driver for MA35D1 SoC.

config CLK_WPCM450
	bool "Nuvoton WPCM450 clock/reset controller support"
	default y
	select RESET_CONTROLLER
	select RESET_SIMPLE
	help
	  Build the clock and reset controller driver for the WPCM450 SoC.

endif
```

## drivers/misc/mediatek/skeyprovider/Kconfig
```kconfig
config MTK_SECURITY_ENHANCEMENT
	bool "MTK_SECURITY_ENHANCEMENT"
	depends on MTK_IN_HOUSE_TEE_SUPPORT
	default y
	help
	  MTK Security Enhancement.
```

## drivers/misc/nbx_ec_ipc/Kconfig
```kconfig
# 2012-04-12: File added and changed by Sony Corporation
# NBX EC IPC

config NBX_EC_IPC
       tristate "Enable NBX EC IPC driver"
       depends on MACH_NBX02 || MACH_NBX03
       help
         This option enables support NBX EC IPC

config NBX_EC_TTY
       tristate "Enable NBX EC IR tty driver"
       depends on NBX_EC_IPC
       help
         This option enables support NBX EC IR tty

config NBX_EC_IPC_LID_SWITCH
       tristate "Enable NBX EC lid switch driver"
       depends on NBX_EC_IPC
       help
         This option enables support NBX EC lid switch
```

## drivers/mmc/sunxi-host/Kconfig
```kconfig
#
# MMC/SD host controller drivers
#

comment "SUNXI MMC/SD/SDIO Host Controller Drivers"

config MMC_SUNXI
	tristate "SUNXI MMC Card Interface support"
	depends on MMC
	help
	  This selects Reuuimlla SUNXI card support.  If you have an SUNXI
	  platform with a Multimedia Card slot, say Y or M here.

	  If unsure, say N.
	  
config MMC_SUNXI_DBG
	bool "SUNXI MMC Card Host driver debug control"
	depends on MMC_SUNXI
	
config MMC_SUNXI_KEEP_POWER_IN_SUSPEND
	bool "Keep MMC0 power on in suspend"
	depends on MMC_SUNXI
	help
		Keep power on external MMC while device is in suspend.
	
```

## drivers/mtd/spichips/Kconfig
```kconfig
# drivers/mtd/chips/Kconfig
# $Id: Kconfig,v 1.18 2005/11/07 11:14:22 gleixner Exp $

menu "SPI Flash chip drivers"
	depends on MTD!=n

config MTD_SPI
	bool "Enable MTD support on SPI devices"
	depends on MTD
	help
	  Select this if you want to access SPI flash devices via MTD

config MTD_SPI_INTEL_S33
	bool "Intel S33 SPI devices Support"
	depends on MTD_SPI
	help
	  Select this if you want to use Intel S33 SPI devices

config MTD_SPI_AT
	bool "Atmel SPI devices Support"
	depends on MTD_SPI
	help
	  Select this if you want to use Atmel SPI devices

config MTD_SPI_ST
	bool "ST Micro SPI devices Support"
	depends on MTD_SPI
	help
	  Select this if you want to use ST Microelectronics SPI devices

endmenu
```

## drivers/mtk/Kconfig
```kconfig
menu "MediaTek MT53XX Series Support"

config MT5396_DRIVERS
        tristate "MT5396 drivers support"
        default n
        depends on ARCH_MT5396
        help
          Include all the mt5396 drivers.

config MT5368_DRIVERS
        tristate "MT5368 drivers support"
        default n
        depends on ARCH_MT5368
        help
          Include all the mt5368 drivers.

config MT5389_DRIVERS
        tristate "MT5389 drivers support"
        default n
        depends on ARCH_MT5389
        help
          Include all the mt5389 drivers.
endmenu
```

## arch/arm/configs/aud8516m3v4_slc_avs_yocto_debug_defconfig
```kconfig
CONFIG_ZSMALLOC=y
CONFIG_ZRAM=y
CONFIG_ZISOFS=y
CONFIG_XFRM_USER=y
CONFIG_XFRM_SUB_POLICY=y
CONFIG_XFRM_MIGRATE=y
CONFIG_WATCHDOG=y
CONFIG_VLAN_8021Q=y
CONFIG_VFAT_FS=y
CONFIG_USB_STORAGE_USBAT=y
CONFIG_USB_STORAGE_SDDR55=y
CONFIG_USB_STORAGE_SDDR09=y
CONFIG_USB_STORAGE_ONETOUCH=y
CONFIG_USB_STORAGE_KARMA=y
CONFIG_USB_STORAGE_JUMPSHOT=y
CONFIG_USB_STORAGE_ISD200=y
CONFIG_USB_STORAGE_FREECOM=y
CONFIG_USB_STORAGE_DEBUG=y
CONFIG_USB_STORAGE_DATAFAB=y
CONFIG_USB_STORAGE_CYPRESS_ATACB=y
CONFIG_USB_STORAGE_ALAUDA=y
CONFIG_USB_STORAGE=y
CONFIG_USB_SERIAL_OPTION=y
CONFIG_USB_SERIAL=y
CONFIG_USB_MTK_OTG=y
CONFIG_USB_MTK_HDRC=y
CONFIG_USB_G_ANDROID=y
CONFIG_USB_GADGET=y
CONFIG_USB=y
CONFIG_UNIX=y
CONFIG_UBIFS_FS_ADVANCED_COMPR=y
CONFIG_UBIFS_FS=y
CONFIG_TMPFS_POSIX_ACL=y
CONFIG_TMPFS=y
CONFIG_TIMER_STATS=y
CONFIG_THERMAL_DEFAULT_GOV_BACKWARD_COMPATIBLE=y
CONFIG_THERMAL=y
CONFIG_SYSVIPC=y
CONFIG_SYN_COOKIES=y
CONFIG_SYNC=y
CONFIG_SW_SYNC_USER=y
CONFIG_SW_SYNC=y
CONFIG_SWP_EMULATION=y
CONFIG_SWITCH=y
CONFIG_STAGING=y
CONFIG_SPI=y
CONFIG_SOUND_PRIME=y
CONFIG_SOUND=y
CONFIG_SND_VERBOSE_PRINTK=y
CONFIG_SND_USB_AUDIO=y
CONFIG_SND_SOC_MT8167S_SOM_MACH=y
CONFIG_SND_SOC=y
CONFIG_SND_SIMPLE_CARD=y
CONFIG_SND_SEQ_DUMMY=y
CONFIG_SND_SEQUENCER_OSS=y
CONFIG_SND_SEQUENCER=y
CONFIG_SND_PCM_XRUN_DEBUG=y
CONFIG_SND_HRTIMER=y
CONFIG_SND_DYNAMIC_MINORS=y
CONFIG_SND=y
CONFIG_SETEND_EMULATION=y
CONFIG_SERIAL_8250_MT6577=y
CONFIG_SERIAL_8250_CONSOLE=y
CONFIG_SERIAL_8250=y
CONFIG_SECURITY_NETWORK=y
CONFIG_SECURITY=y
CONFIG_SECCOMP=y
CONFIG_SCSI_SCAN_ASYNC=y
CONFIG_SCSI=y
CONFIG_SCHED_MC=y
CONFIG_SCHEDSTATS=y
CONFIG_RT_GROUP_SCHED=y
CONFIG_RTC_DRV_MT6397=y
CONFIG_RTC_CLASS=y
CONFIG_REGULATOR_MT6392=y
CONFIG_REGULATOR_FIXED_VOLTAGE=y
CONFIG_REGULATOR=y
CONFIG_RCU_CPU_STALL_TIMEOUT=60
CONFIG_PRINTK_TIME=y
CONFIG_PREEMPT=y
CONFIG_POWER_EXT=y
CONFIG_POSIX_MQUEUE=y
CONFIG_PM_WAKELOCKS=y
CONFIG_PM_AUTOSLEEP=y
CONFIG_PANIC_TIMEOUT=5
CONFIG_PANIC_ON_OOPS=y
CONFIG_PACKET=y
CONFIG_NVMEM=y
CONFIG_NR_CPUS=4
CONFIG_NO_HZ=y
CONFIG_NOP_USB_XCEIV=y
CONFIG_NLS_UTF8=y
CONFIG_NLS_ISO8859_1=y
CONFIG_NLS_CODEPAGE_950=y
CONFIG_NLS_CODEPAGE_437=y
CONFIG_NLS_ASCII=y
CONFIG_NL80211_TESTMODE=y
CONFIG_NF_CT_PROTO_UDPLITE=y
CONFIG_NF_CT_NETLINK=y
CONFIG_NF_CONNTRACK_TFTP=y
CONFIG_NF_CONNTRACK_PPTP=y
CONFIG_NF_CONNTRACK_IPV4=y
CONFIG_NF_CONNTRACK_FTP=y
CONFIG_NF_CONNTRACK_EVENTS=y
CONFIG_NF_CONNTRACK=y
CONFIG_NEW_LEDS=y
CONFIG_NET_VENDOR_MEDIATEK=y
CONFIG_NET_SCH_INGRESS=y
CONFIG_NET_SCH_HTB=y
CONFIG_NET_SCHED=y
CONFIG_NET_KEY=y
CONFIG_NET_IPIP=y
CONFIG_NET_DROP_MONITOR=y
CONFIG_NET_CLS_U32=y
CONFIG_NET_CLS_IND=y
CONFIG_NET_CLS_FW=y
CONFIG_NET_CLS_FLOW=y
CONFIG_NET_CLS_ACT=y
CONFIG_NET_ACT_POLICE=y
CONFIG_NET_ACT_MIRRED=y
CONFIG_NET_ACT_IPT=y
CONFIG_NETFILTER_XT_TARGET_TCPMSS=y
CONFIG_NETFILTER_XT_TARGET_NFQUEUE=y
CONFIG_NETFILTER_XT_TARGET_NFLOG=y
CONFIG_NETFILTER_XT_TARGET_MARK=y
CONFIG_NETFILTER_XT_TARGET_IDLETIMER=y
CONFIG_NETFILTER_XT_TARGET_CLASSIFY=y
CONFIG_NETFILTER_XT_MATCH_U32=y
CONFIG_NETFILTER_XT_MATCH_TIME=y
CONFIG_NETFILTER_XT_MATCH_TCPMSS=y
CONFIG_NETFILTER_XT_MATCH_STRING=y
CONFIG_NETFILTER_XT_MATCH_STATISTIC=y
CONFIG_NETFILTER_XT_MATCH_STATE=y
CONFIG_NETFILTER_XT_MATCH_SOCKET=y
CONFIG_NETFILTER_XT_MATCH_RECENT=y
CONFIG_NETFILTER_XT_MATCH_REALM=y
CONFIG_NETFILTER_XT_MATCH_QUOTA=y
CONFIG_NETFILTER_XT_MATCH_QUOTA2_LOG=y
CONFIG_NETFILTER_XT_MATCH_QUOTA2=y
CONFIG_NETFILTER_XT_MATCH_QTAGUID=y
CONFIG_NETFILTER_XT_MATCH_POLICY=y
CONFIG_NETFILTER_XT_MATCH_PHYSDEV=y
CONFIG_NETFILTER_XT_MATCH_MULTIPORT=y
CONFIG_NETFILTER_XT_MATCH_MARK=y
CONFIG_NETFILTER_XT_MATCH_MAC=y
CONFIG_NETFILTER_XT_MATCH_LIMIT=y
CONFIG_NETFILTER_XT_MATCH_LENGTH=y
CONFIG_NETFILTER_XT_MATCH_IPRANGE=y
CONFIG_NETFILTER_XT_MATCH_CONNBYTES=y
CONFIG_NETFILTER_XT_CONNMARK=y
CONFIG_NETFILTER=y
CONFIG_NETDEVICES=y
CONFIG_NET=y
CONFIG_NAMESPACES=y
CONFIG_MTK_USBFSH=y
CONFIG_MTK_UART_USB_SWITCH=y
CONFIG_MTK_SYNC=y
CONFIG_MTK_SECURE_EFUSE=y
CONFIG_MTK_SCHED_RQAVG_US=y
CONFIG_MTK_SCHED_RQAVG_KS=y
CONFIG_MTK_SCHED_INTEROP=y
CONFIG_MTK_RAM_CONSOLE_SIZE=0x3000
CONFIG_MTK_RAM_CONSOLE_ADDR=0xF912D000
CONFIG_MTK_RAM_CONSOLE=y
CONFIG_MTK_PWM=y
CONFIG_MTK_PSCI=y
CONFIG_MTK_PMIC_WRAP=y
CONFIG_MTK_PLATFORM="mt8167"
CONFIG_MTK_MUSB_PORT0_LOWPOWER_MODE=y
CONFIG_MTK_MUSBFSH_QMU_SUPPORT=y
CONFIG_MTK_LOAD_BALANCE_ENHANCEMENT=y
CONFIG_MTK_L2C_PARITY_CHECK=y
CONFIG_MTK_IRRX_NEC=y
CONFIG_MTK_IRRX=y
CONFIG_MTK_IN_HOUSE_TEE_SUPPORT=y
CONFIG_MTK_INTERNAL=y
CONFIG_MTK_GMO_RAM_OPTIMIZE=y
CONFIG_MTK_FREQ_HOPPING=y
CONFIG_MTK_EFUSE=y
CONFIG_MTK_DYNAMIC_BOOST=y
CONFIG_MTK_DRM_KEY_MNG_SUPPORT=y
CONFIG_MTK_DRAMC=y
CONFIG_MTK_CPU_TOPOLOGY=y
CONFIG_MTK_CPU_AFFINITY=y
CONFIG_MTK_COMBO_WIFI=m
CONFIG_MTK_COMBO_COMM_SDIO=n
CONFIG_MTK_COMBO_COMM=n
CONFIG_MTK_COMBO_CHIP_MT7668=y
CONFIG_MTK_COMBO_CHIP_MT6630=n
CONFIG_MTK_COMBO=y
CONFIG_MTK_CHIP=y
CONFIG_MTK_BTCVSD_ALSA=y
CONFIG_MTK_ANDROID_BINDER_32BIT=y
CONFIG_MTK_AEE_FEATURE=n
CONFIG_MTK_ACCDET=y
CONFIG_MTK_AAL_SUPPORT=y
CONFIG_MTD_VERITY=n
CONFIG_MTD_UBI=y
CONFIG_MTD_NAND_MTK=y
CONFIG_MTD_NAND=y
CONFIG_MTD48=y
CONFIG_MT6397_MISC=y
CONFIG_MSDOS_FS=y
CONFIG_MODULES=y
CONFIG_MMC_MTK_COMM_SDIO=y
CONFIG_MMC_MTK=y
CONFIG_MMC_BLOCK_MINORS=32
CONFIG_MMC=y
CONFIG_MFD_MT6397=y
CONFIG_MEDIA_SUPPORT=y
CONFIG_MEDIA_RC_SUPPORT=y
CONFIG_MEDIATEK_WATCHDOG=y
CONFIG_MEDIATEK_STAR=y
CONFIG_MEDIATEK_SOLUTION=y
CONFIG_MACH_MT8167=y
CONFIG_LIRC=y
CONFIG_LIBCRC32C=y
CONFIG_LEGACY_PTY_COUNT=16
CONFIG_LEDS_TRIGGER_TIMER=y
CONFIG_LEDS_TRIGGERS=y
CONFIG_LEDS_LP5523=y
CONFIG_LEDS_LP5521=y
CONFIG_LEDS_CLASS=y
CONFIG_KEYBOARD_MTK_PMIC=y
CONFIG_KEYBOARD_MTK=y
CONFIG_KEYBOARD_GPIO=y
CONFIG_IP_PNP_DHCP=y
CONFIG_IP_PNP_BOOTP=y
CONFIG_IP_PNP=y
CONFIG_IP_PIMSM_V2=y
CONFIG_IP_PIMSM_V1=y
CONFIG_IP_NF_TARGET_REJECT=y
CONFIG_IP_NF_TARGET_REDIRECT=y
CONFIG_IP_NF_TARGET_NETMAP=y
CONFIG_IP_NF_TARGET_MASQUERADE=y
CONFIG_IP_NF_RAW=y
CONFIG_IP_NF_NAT=y
CONFIG_IP_NF_MANGLE=y
CONFIG_IP_NF_IPTABLES=y
CONFIG_IP_NF_FILTER=y
CONFIG_IP_NF_ARPTABLES=y
CONFIG_IP_MULTIPLE_TABLES=y
CONFIG_IP_MULTICAST=y
CONFIG_IP_MROUTE_MULTIPLE_TABLES=y
CONFIG_IP_MROUTE=y
CONFIG_IP_ADVANCED_ROUTER=y
CONFIG_IPV6=n
CONFIG_IP6_NF_TARGET_REJECT=y
CONFIG_IP6_NF_TARGET_HL=y
CONFIG_IP6_NF_RAW=y
CONFIG_IP6_NF_MATCH_FRAG=y
CONFIG_IP6_NF_MANGLE=y
CONFIG_IP6_NF_IPTABLES=y
CONFIG_IP6_NF_FILTER=y
CONFIG_INPUT_UINPUT=y
CONFIG_INPUT_MISC=y
CONFIG_INPUT_EVDEV=y
CONFIG_INET_IPCOMP=y
CONFIG_INET_ESP=y
CONFIG_INET_DIAG_DESTROY=y
CONFIG_INET_AH=y
CONFIG_INET=y
CONFIG_IFB=y
CONFIG_I2C_MT65XX=y
CONFIG_HW_RANDOM=y
CONFIG_HIGH_RES_TIMERS=y
CONFIG_GPIO_SYSFS=y
CONFIG_FRAME_WARN=1400
CONFIG_FHANDLE=y
CONFIG_FAULT_INJECTION=y
CONFIG_FAT_FS=y
CONFIG_EMBEDDED=y
CONFIG_DEVTMPFS_MOUNT=y
CONFIG_DEVTMPFS=y
CONFIG_DEBUG_FS=y
CONFIG_CRYPTO_XCBC=y
CONFIG_CRYPTO_TWOFISH=y
CONFIG_CRYPTO_SHA512=y
CONFIG_CRYPTO_ECHAINIV=y
CONFIG_CRYPTO_CTR=y
CONFIG_CROSS_COMPILE="aarch64-linux-android-"
CONFIG_CPU_FREQ_STAT_DETAILS=y
CONFIG_CPU_FREQ_GOV_USERSPACE=y
CONFIG_CPU_FREQ_GOV_POWERSAVE=y
CONFIG_CPU_FREQ_GOV_PERFORMANCE=y
CONFIG_CPU_FREQ_GOV_ONDEMAND=y
CONFIG_CPU_FREQ_DEFAULT_GOV_INTERACTIVE=y
CONFIG_CPU_FREQ=y
CONFIG_CPUFREQ_DT=y
CONFIG_CP15_BARRIER_EMULATION=y
CONFIG_COMPAT=y
CONFIG_CMDLINE="console=tty0 console=ttyMT0,921600n1 root=/dev/ram vmalloc=496M slub_max_order=0 slub_debug=O loglevel=8 initcall_debug gpt "
CONFIG_CLS_U32_PERF=y
CONFIG_CLS_U32_MARK=y
CONFIG_CGROUP_SCHED=y
CONFIG_CGROUP_CPUACCT=y
CONFIG_CGROUPS=y
CONFIG_CFG80211_WEXT=y
CONFIG_CFG80211_DEVELOPER_WARNINGS=y
CONFIG_CFG80211=y
CONFIG_CC_OPTIMIZE_FOR_SIZE=y
CONFIG_BUILD_ARM64_APPENDED_DTB_IMAGE_NAMES="mediatek/aud8516m3v4_slc_yocto"
CONFIG_BUILD_ARM64_APPENDED_DTB_IMAGE=y
CONFIG_BRIDGE_NETFILTER=y
CONFIG_BRIDGE=y
CONFIG_BLK_DEV_SD=y
CONFIG_BLK_DEV_LOOP=y
CONFIG_AUXADC_NOT_CONTROL_APMIXED_BASE=y
CONFIG_AUXADC_NEED_POWER_ON=y
CONFIG_AUDIT=y
CONFIG_ASHMEM=y
CONFIG_ARMV8_DEPRECATED=y
CONFIG_ARCH_MTK_PROJECT="aud8516m3v4_slc_yocto"
CONFIG_ARCH_MEDIATEK=y
CONFIG_ANDROID_LOW_MEMORY_KILLER=y
CONFIG_ANDROID_LOGGER=y
CONFIG_ANDROID_BINDER_IPC=y
CONFIG_ANDROID=y
CONFIG_ACCDET_EINT=y
#CONFIG_MTK_BTIF=y
#CONFIG_BLK_DEV_INITRD is not set
#####for logger #############
# start for usb storage support, if you need not to support, it can be removed
# end for usb storage support
# CONFIG_VT is not set
# CONFIG_THUMB2_KERNEL is not set
# CONFIG_SYSCTL_SYSCALL is not set
# CONFIG_SND_SPI is not set
# CONFIG_SLUB_DEBUG is not set
# CONFIG_SCSI_LOWLEVEL is not set
# CONFIG_RTC_SYSTOHC is not set
# CONFIG_RC_MAP is not set
# CONFIG_PROFILING is not set
# CONFIG_PPP_SYNC_TTY is not set
# CONFIG_PPP_MULTILINK is not set
# CONFIG_PPP_MPPE is not set
# CONFIG_PPP_FILTER is not set
# CONFIG_PPP_DEFLATE is not set
# CONFIG_PPP_BSDCOMP is not set
# CONFIG_PPP_ASYNC is not set
# CONFIG_PPPOPNS is not set
# CONFIG_PPPOLAC is not set
# CONFIG_PPPOE is not set
# CONFIG_PPP is not set
# CONFIG_PINCTRL_MT8173 is not set
# CONFIG_NF_CONNTRACK_IPV6 is not set
# CONFIG_NETWORK_FILESYSTEMS is not set
# CONFIG_MTK_WD_KICKER is not set
# CONFIG_MTK_WATCHDOG is not set
# CONFIG_MTK_SERIAL is not set
# CONFIG_MTK_SEC_VIDEO_PATH_SUPPORT is not set
# CONFIG_MTK_PMIC_WRAP_HAL is not set
# CONFIG_MTK_M4U is not set
# CONFIG_MTK_LEDS=y
# CONFIG_MTK_GPU_SUPPORT is not set
# CONFIG_MTK_GPIO is not set
# CONFIG_MTK_FB=y
# CONFIG_MTK_EMI_MPU is not set
# CONFIG_MTK_EMI_MBW is not set
# CONFIG_MTK_CONN_LTE_IDC_SUPPORT is not set
# CONFIG_MTK_COMBO_GPS=y
# CONFIG_MTK_COMBO_BT=y
# CONFIG_MTK_CMDQ_TAB is not set
# CONFIG_MTK_CMDQ is not set
# CONFIG_MTK_CCCI_DEVICES is not set
# CONFIG_MTK_CACHE_DUMP is not set
# CONFIG_LOCALVERSION_AUTO is not set
# CONFIG_IR_SONY_DECODER is not set
# CONFIG_IR_SANYO_DECODER is not set
# CONFIG_IR_RC6_DECODER is not set
# CONFIG_IR_RC5_DECODER is not set
# CONFIG_IR_NEC_DECODER is not set
# CONFIG_IR_MCE_KBD_DECODER is not set
# CONFIG_IR_LIRC_CODEC is not set
# CONFIG_IR_JVC_DECODER is not set
# CONFIG_IPV6_TUNNEL is not set
# CONFIG_IPV6_SUBTREES is not set
# CONFIG_IPV6_SIT_6RD is not set
# CONFIG_IPV6_ROUTE_INFO is not set
# CONFIG_IPV6_ROUTER_PREF is not set
# CONFIG_IPV6_PIMSM_V2 is not set
# CONFIG_IPV6_OPTIMISTIC_DAD is not set
# CONFIG_IPV6_MULTIPLE_TABLES is not set
# CONFIG_IPV6_MROUTE is not set
# CONFIG_IPV6_MIP6 is not set
# CONFIG_IP6_NF_MATCH_IPV6HEADER is not set
# CONFIG_INET_LRO is not set
# CONFIG_INET6_XFRM_MODE_ROUTEOPTIMIZATION is not set
# CONFIG_INET6_IPCOMP is not set
# CONFIG_INET6_ESP is not set
# CONFIG_INET6_AH is not set
# CONFIG_I2C_MTK is not set
# CONFIG_HWMON is not set
# CONFIG_EFI is not set
# CONFIG_DRM is not set
# CONFIG_DEVMEM is not set
# CONFIG_DEVKMEM is not set
# CONFIG_DEBUG_BUGVERBOSE is not set
# CONFIG_CUSTOM_KERNEL_IMGSENSOR="imx219_mipi_raw gc2355_mipi_raw"
# CONFIG_CRYPTO_HW is not set
# CONFIG_CORE_DUMP_DEFAULT_ELF_HEADERS is not set
# CONFIG_CFG80211_DEFAULT_PS is not set
# CONFIG_BOUNCE is not set
# CONFIG_BLK_DEV_BSG is not set
```

## Documentation/devicetree/bindings/arm/npcm/nuvoton,shm.yaml
```yaml
# SPDX-License-Identifier: GPL-2.0-only OR BSD-2-Clause
%YAML 1.2
---
$id: http://devicetree.org/schemas/arm/npcm/nuvoton,gcr.yaml#
$schema: http://devicetree.org/meta-schemas/core.yaml#

title: Shared Memory block in Nuvoton SoCs

maintainers:
  - Jonathan Neuschäfer <j.neuschaefer@gmx.net>

description:
  The Shared Memory interface (SHM) is a piece of hardware in Nuvoton BMCs
  that allows a host processor (connected via LPC) to access flash and RAM
  that belong to the BMC. The SHM includes a register block accessible from
  the BMC side.

properties:
  compatible:
    items:
      - enum:
          - nuvoton,wpcm450-shm
      - const: syscon

  reg:
    maxItems: 1

required:
  - compatible
  - reg

examples:
  - |
    shm: syscon@c8001000 {
      compatible = "nuvoton,wpcm450-shm", "syscon";
      reg = <0xc8001000 0x1000>;
    };
```

## Documentation/devicetree/bindings/clock/nuvoton,wpcm450-clk.yaml
```yaml
# SPDX-License-Identifier: (GPL-2.0-only OR BSD-2-Clause)
%YAML 1.2
---
$id: http://devicetree.org/schemas/clock/nuvoton,wpcm450-clk.yaml#
$schema: http://devicetree.org/meta-schemas/core.yaml#

title: Nuvoton WPCM450 clock controller

maintainers:
  - Jonathan Neuschäfer <j.neuschaefer@gmx.net>

description:
  The clock controller of the Nuvoton WPCM450 SoC supplies clocks and resets to
  the rest of the chip.

properties:
  compatible:
    const: nuvoton,wpcm450-clk

  reg:
    maxItems: 1

  clocks:
    items:
      - description: Reference clock oscillator (should be 48 MHz)

  clock-names:
    items:
      - const: ref

  '#clock-cells':
    const: 1

  '#reset-cells':
    const: 1

additionalProperties: false

required:
  - compatible
  - reg
  - clocks
  - clock-names
  - '#clock-cells'

examples:
  - |
    #include <dt-bindings/clock/nuvoton,wpcm450-clk.h>
    #include <dt-bindings/interrupt-controller/irq.h>

    refclk: clock-48mhz {
      /* 48 MHz reference oscillator */
      compatible = "fixed-clock";
      clock-frequency = <48000000>;
      #clock-cells = <0>;
    };

    clk: clock-controller@b0000200 {
      reg = <0xb0000200 0x100>;
      compatible = "nuvoton,wpcm450-clk";
      clocks = <&refclk>;
      clock-names = "ref";
      #clock-cells = <1>;
      #reset-cells = <1>;
    };
```

## Documentation/devicetree/bindings/net/nuvoton,emc.yaml
```yaml
# SPDX-License-Identifier: GPL-2.0 OR BSD-2-Clause
%YAML 1.2
---
$id: "http://devicetree.org/schemas/net/nuvoton,emc.yaml#"
$schema: "http://devicetree.org/meta-schemas/core.yaml#"

title: Nuvoton 10/100 Mbit Ethernet MAC Controller (EMC)

allOf:
  - $ref: ethernet-controller.yaml#

maintainers:
  - Jonathan Neuschäfer <j.neuschaefer@gmx.net>

properties:
  compatible:
    enum:
      - nuvoton,wpcm450-emc
      - nuvoton,npcm750-emc

  reg:
    maxItems: 1

  interrupts:
    items:
      - description: TX interrupt
      - description: RX interrupt

  clocks:
    items:
      - description: AHB interface clock
      - description: RMII reference clock

  clock-names:
    items:
      - const: main
      - const: RMII

  resets:
    maxItems: 1

  mdio:
    $ref: mdio.yaml#
    unevaluatedProperties: false

  use-ncsi:
    type: boolean
    description: Use the NC-SI stack instead of an MDIO PHY

required:
  - compatible
  - reg
  - interrupts

additionalProperties: false

examples:
  - |
    #include <dt-bindings/interrupt-controller/irq.h>
    #include <dt-bindings/clock/nuvoton,wpcm450-clk.h>
    ethernet0: ethernet@b0002000 {
        compatible = "nuvoton,wpcm450-emc";
        reg = <0xb0002000 0x1000>;
        interrupts = <16 IRQ_TYPE_LEVEL_HIGH>, <15 IRQ_TYPE_LEVEL_HIGH>;
        clocks = <&clk WPCM450_CLK_EMC0>, <&rmii_clk>;
        clock-names = "main", "RMII";
        resets = <&clk WPCM450_RESET_EMC0>;

        mdio {
            #address-cells = <1>;
            #size-cells = <0>;

            eth_phy: ethernet-phy@3 {
                reg = <0x3>;
            };
        };
    };
```

## Documentation/devicetree/bindings/pwm/netronix,msp430-ec-pwm.txt
```
PWM functionality in MSP430-based Netronix Embedded Controller

Required properties:
- compatible: should be "netronix,msp430-ec-pwm"
- #pwm-cells: Should be 1.

Available PWM channels:
- 0: The PWM channel controlled by registers 0xa1-0xa7

Example:

	embedded-controller@43 {
		compatible = "netronix,msp430-ec";
		...

		ec_pwm: pwm {
			compatible = "netronix,msp430-ec-pwm";
			#pwm-cells = <1>;
		};
	};

	...

	backlight {
		compatible = "pwm-backlight";
		pwms = <&ec_pwm 0 50000>;
	};
```

## Kconfig
```kconfig
#
# For a description of the syntax of this configuration file,
# see Documentation/kbuild/kconfig-language.txt.
#
mainmenu "Linux/$ARCH $KERNELVERSION Kernel Configuration"

config SRCARCH
	string
	option env="SRCARCH"

source "arch/$SRCARCH/Kconfig"

source "Kconfig.bcm_kf"

source "Kconfig.bcm"

config BCM_IN_KERNEL
	bool
	default y
```

## Kconfig.hw
```kconfig
config ATP_SUPPORT_DOUBLE_SYSTEM
	bool "Sure to support double system "
	default y
	
config ATP_USB_ADAPTOR
	bool "atp usb adaptor"
	default n

config INTERNET_LED_SINGTEL
	bool "Internet Led"
	default n 
	depends on BCM96362	
		
	
config BCM96362_DAYINGGASP
	bool "Implementation daying gasp"
    depends on BCM96362
	default n
	help	
	  This options enables the support of dayinggasp		  
	
config ATP_SUPPORT_ETHERNETLED
	bool "Ethernet Led"
	default n 
	depends on BCM963268	
config SPI_MAX3100_CONSOLE
	bool "SUPPORT SPI TO UART MAX3100 CONSOLE"
	default n
	depends on SERIAL_MAX3100
```

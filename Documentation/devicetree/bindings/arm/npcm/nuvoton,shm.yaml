## arch/arm/configs/wpcm450_defconfig
```kconfig
CONFIG_SYSVIPC=y
CONFIG_NO_HZ=y
CONFIG_HIGH_RES_TIMERS=y
CONFIG_PREEMPT=y
CONFIG_IKCONFIG=y
CONFIG_IKCONFIG_PROC=y
CONFIG_LOG_BUF_SHIFT=19
CONFIG_CGROUPS=y
CONFIG_BLK_DEV_INITRD=y
CONFIG_CC_OPTIMIZE_FOR_SIZE=y
CONFIG_PROFILING=y
# CONFIG_ARCH_MULTI_V7 is not set
CONFIG_ARCH_NPCM=y
CONFIG_ARCH_WPCM450=y
CONFIG_CPU_DCACHE_WRITETHROUGH=y
CONFIG_AEABI=y
CONFIG_HIGHMEM=y
CONFIG_UACCESS_WITH_MEMCPY=y
CONFIG_ARM_APPENDED_DTB=y
CONFIG_CMDLINE="earlyprintk debug"
CONFIG_CMDLINE_EXTEND=y
CONFIG_KEXEC=y
# CONFIG_ATAGS_PROC is not set
CONFIG_CPU_FREQ=y
CONFIG_CPU_FREQ_STAT=y
CONFIG_CPU_FREQ_DEFAULT_GOV_ONDEMAND=y
CONFIG_CPU_IDLE=y
CONFIG_OPROFILE=y
CONFIG_KPROBES=y
CONFIG_MODULES=y
CONFIG_MODULE_UNLOAD=y
CONFIG_NET=y
CONFIG_PACKET=y
CONFIG_UNIX=y
CONFIG_INET=y
CONFIG_IP_MULTICAST=y
CONFIG_IP_PNP=y
CONFIG_IP_PNP_DHCP=y
CONFIG_IP_PNP_BOOTP=y
CONFIG_NET_DSA=y
CONFIG_NET_DSA_TAG_DSA=y
CONFIG_NET_DSA_TAG_EDSA=y
CONFIG_NET_DSA_TAG_TRAILER=y
CONFIG_NET_PKTGEN=m
# CONFIG_WIRELESS is not set
CONFIG_DEVTMPFS=y
CONFIG_DEVTMPFS_MOUNT=y
CONFIG_MTD=y
CONFIG_MTD_CMDLINE_PARTS=y
CONFIG_MTD_BLOCK=y
CONFIG_MTD_CFI=y
CONFIG_MTD_JEDECPROBE=y
CONFIG_MTD_CFI_ADV_OPTIONS=y
CONFIG_MTD_CFI_GEOMETRY=y
# CONFIG_MTD_MAP_BANK_WIDTH_4 is not set
CONFIG_MTD_CFI_INTELEXT=y
CONFIG_MTD_CFI_STAA=y
CONFIG_MTD_PHYSMAP=y
CONFIG_MTD_SPI_NOR=y
CONFIG_BLK_DEV_LOOP=y
CONFIG_SRAM=y
CONFIG_EEPROM_AT24=y
CONFIG_SCSI=y
# CONFIG_SCSI_PROC_FS is not set
# CONFIG_SCSI_LOWLEVEL is not set
CONFIG_NETDEVICES=y
# CONFIG_NET_VENDOR_ALACRITECH is not set
# CONFIG_NET_VENDOR_AMAZON is not set
# CONFIG_NET_VENDOR_AQUANTIA is not set
# CONFIG_NET_VENDOR_ARC is not set
# CONFIG_NET_VENDOR_AURORA is not set
# CONFIG_NET_VENDOR_BROADCOM is not set
# CONFIG_NET_VENDOR_CADENCE is not set
# CONFIG_NET_VENDOR_CAVIUM is not set
# CONFIG_NET_VENDOR_CIRRUS is not set
# CONFIG_NET_VENDOR_CORTINA is not set
# CONFIG_NET_VENDOR_EZCHIP is not set
# CONFIG_NET_VENDOR_FARADAY is not set
# CONFIG_NET_VENDOR_GOOGLE is not set
# CONFIG_NET_VENDOR_HISILICON is not set
# CONFIG_NET_VENDOR_HUAWEI is not set
# CONFIG_NET_VENDOR_INTEL is not set
# CONFIG_NET_VENDOR_MARVELL is not set
# CONFIG_NET_VENDOR_MELLANOX is not set
# CONFIG_NET_VENDOR_MICREL is not set
# CONFIG_NET_VENDOR_MICROCHIP is not set
# CONFIG_NET_VENDOR_MICROSEMI is not set
# CONFIG_NET_VENDOR_NATSEMI is not set
# CONFIG_NET_VENDOR_NETRONOME is not set
# CONFIG_NET_VENDOR_NI is not set
# CONFIG_NET_VENDOR_PENSANDO is not set
# CONFIG_NET_VENDOR_QUALCOMM is not set
# CONFIG_NET_VENDOR_RENESAS is not set
# CONFIG_NET_VENDOR_ROCKER is not set
# CONFIG_NET_VENDOR_SAMSUNG is not set
# CONFIG_NET_VENDOR_SEEQ is not set
# CONFIG_NET_VENDOR_SOLARFLARE is not set
# CONFIG_NET_VENDOR_SMSC is not set
# CONFIG_NET_VENDOR_SOCIONEXT is not set
# CONFIG_NET_VENDOR_STMICRO is not set
# CONFIG_NET_VENDOR_SYNOPSYS is not set
# CONFIG_NET_VENDOR_VIA is not set
# CONFIG_NET_VENDOR_WIZNET is not set
# CONFIG_NET_VENDOR_XILINX is not set
CONFIG_DAVICOM_PHY=y
CONFIG_MARVELL_PHY=y
CONFIG_MICREL_PHY=y
CONFIG_REALTEK_PHY=y
# CONFIG_WLAN is not set
CONFIG_INPUT_EVDEV=y
CONFIG_KEYBOARD_QT1070=m
CONFIG_KEYBOARD_GPIO=y
# CONFIG_INPUT_MOUSE is not set
CONFIG_VT_HW_CONSOLE_BINDING=y
CONFIG_LEGACY_PTY_COUNT=16
CONFIG_SERIAL_8250=y
CONFIG_SERIAL_8250_CONSOLE=y
CONFIG_SERIAL_8250_NR_UARTS=6
CONFIG_SERIAL_8250_RUNTIME_UARTS=6
CONFIG_SERIAL_8250_EXTENDED=y
CONFIG_SERIAL_8250_MANY_PORTS=y
CONFIG_SERIAL_8250_ASPEED_VUART=m
CONFIG_SERIAL_OF_PLATFORM=y
CONFIG_HW_RANDOM=y
CONFIG_HW_RANDOM_TIMERIOMEM=m
CONFIG_I2C=y
# CONFIG_I2C_COMPAT is not set
CONFIG_I2C_CHARDEV=y
CONFIG_I2C_MUX=y
CONFIG_SPI=y
CONFIG_SPI_BITBANG=y
CONFIG_SPI_NPCM_FIU=y
CONFIG_SPI_NPCM_PSPI=y
CONFIG_PTP_1588_CLOCK=y
CONFIG_PINCTRL_SINGLE=y
CONFIG_GPIOLIB=y
CONFIG_GPIO_PCF857X=y
CONFIG_POWER_RESET=y
CONFIG_POWER_RESET_GPIO=y
CONFIG_POWER_SUPPLY=y
CONFIG_THERMAL=y
CONFIG_WATCHDOG=y
CONFIG_NPCM7XX_WATCHDOG=y
CONFIG_MFD_ATMEL_HLCDC=y
CONFIG_MFD_SYSCON=y
CONFIG_REGULATOR=y
CONFIG_REGULATOR_FIXED_VOLTAGE=y
CONFIG_FB=y
CONFIG_FB_MODE_HELPERS=y
CONFIG_HID_DRAGONRISE=y
CONFIG_HID_GYRATION=y
CONFIG_HID_TWINHAN=y
CONFIG_HID_PANTHERLORD=y
CONFIG_HID_PETALYNX=y
CONFIG_HID_SAMSUNG=y
CONFIG_HID_SUNPLUS=y
CONFIG_HID_GREENASIA=y
CONFIG_HID_SMARTJOYPLUS=y
CONFIG_HID_TOPSEED=y
CONFIG_HID_THRUSTMASTER=y
CONFIG_HID_ZEROPLUS=y
# CONFIG_USB_SUPPORT is not set
CONFIG_MMC=y
CONFIG_SDIO_UART=y
CONFIG_MMC_SDHCI=m
CONFIG_MMC_SDHCI_PLTFM=m
CONFIG_MMC_SDHCI_OF_ASPEED=m
CONFIG_NEW_LEDS=y
CONFIG_LEDS_CLASS=y
CONFIG_LEDS_GPIO=y
CONFIG_LEDS_TRIGGERS=y
CONFIG_LEDS_TRIGGER_TIMER=y
CONFIG_LEDS_TRIGGER_HEARTBEAT=y
CONFIG_LEDS_TRIGGER_DEFAULT_ON=y
CONFIG_RTC_CLASS=y
CONFIG_RTC_DRV_RS5C372=y
CONFIG_RTC_DRV_PCF8563=y
CONFIG_RTC_DRV_S35390A=y
CONFIG_RTC_DRV_RV3029C2=m
CONFIG_DMADEVICES=y
CONFIG_SYNC_FILE=y
# CONFIG_VIRTIO_MENU is not set
# CONFIG_VHOST_MENU is not set
CONFIG_STAGING=y
# CONFIG_IOMMU_SUPPORT is not set
CONFIG_EXTCON=y
CONFIG_MEMORY=y
CONFIG_PWM=y
CONFIG_PWM_ATMEL_HLCDC_PWM=m
CONFIG_WPCM450_INTC=y
CONFIG_RESET_CONTROLLER=y
CONFIG_GENERIC_PHY=y
CONFIG_ISO9660_FS=m
CONFIG_JOLIET=y
CONFIG_UDF_FS=m
CONFIG_MSDOS_FS=y
CONFIG_VFAT_FS=y
CONFIG_TMPFS=y
CONFIG_CONFIGFS_FS=m
# CONFIG_MISC_FILESYSTEMS is not set
# CONFIG_NETWORK_FILESYSTEMS is not set
CONFIG_NLS_CODEPAGE_437=y
CONFIG_NLS_CODEPAGE_850=y
CONFIG_NLS_ISO8859_1=y
CONFIG_NLS_ISO8859_2=y
CONFIG_NLS_UTF8=y
CONFIG_KEYS=y
CONFIG_CRYPTO_RSA=y
CONFIG_CRYPTO_CCM=y
CONFIG_CRYPTO_GCM=y
CONFIG_CRYPTO_CBC=m
CONFIG_CRYPTO_PCBC=m
CONFIG_CRYPTO_CMAC=y
CONFIG_CRYPTO_SHA256=y
CONFIG_CRYPTO_AES=y
CONFIG_CRYPTO_DEFLATE=y
CONFIG_CRYPTO_LZO=y
CONFIG_CRYPTO_ZSTD=y
CONFIG_ASYMMETRIC_KEY_TYPE=y
CONFIG_ASYMMETRIC_PUBLIC_KEY_SUBTYPE=y
CONFIG_X509_CERTIFICATE_PARSER=y
CONFIG_PKCS7_MESSAGE_PARSER=y
CONFIG_SYSTEM_TRUSTED_KEYRING=y
CONFIG_CRC_CCITT=y
CONFIG_CRC16=y
CONFIG_LIBCRC32C=y
CONFIG_PRINTK_TIME=y
CONFIG_DEBUG_INFO=y
CONFIG_MAGIC_SYSRQ=y
CONFIG_DEBUG_FS=y
CONFIG_DEBUG_KERNEL=y
# CONFIG_SCHED_DEBUG is not set
# CONFIG_DEBUG_PREEMPT is not set
# CONFIG_FTRACE is not set
CONFIG_DEBUG_USER=y
CONFIG_DEBUG_LL=y
CONFIG_DEBUG_LL_UART_8250=y
CONFIG_DEBUG_UART_PHYS=0xb8000000
CONFIG_DEBUG_UART_VIRT=0x0ff000000
CONFIG_DEBUG_UART_8250_WORD=y
CONFIG_DEBUG_UNCOMPRESS=y
CONFIG_EARLY_PRINTK=y
```

## arch/arm/mach-avalanche/ti_puma5/Kconfig
```kconfig
menu "TI Puma5 Configuration"
    depends on MACH_PUMA5 = 'y'

#
# All the configuration options specific to a particular SoC come here.
#

# Get to know the reference board the user wants to compile for
choice
	prompt "Puma5 reference board type"
	help
      Select the Puma5 Ref. Design Board that you are using. If you are not 
      using any of these, choose the one closest to your design and make 
      modifications to the kernel as required.

config MACH_PUMA5_VOLCANO
	bool "Volcano FPGA Emulation Board"

config MACH_PUMA5EVM
	bool "Puma5 EVM Board"

endchoice

menu "Puma5 Memory Configuration"

config ARM_AVALANCHE_SDRAM_PHYS_ADDRESS
    hex "ARM physical start address of SDRAM"
    default 0x80000000
    help
        ARM start address in SDRAM.
        For Puma5 it must be 0x80000000.

config ARM_AVALANCHE_SDRAM_PHYS_OFFSET
    hex "ARM Kernel start offset in SDRAM"
    default 0x00000000
    help
        ARM start address in SDRAM.
        For Puma5 it must be 0x40000000.

config ARM_AVALANCHE_KERNEL_ZRELADDR_OFFSET
    hex "ARM Kernel ZRELADDR start offset in kernel space"
    default 0x00018000
    help
        ARM Kernel ZRELADDR start offset from the beginning of the Kernel address space.
        For Puma6 it must be 0x18000

config ARM_AVALANCHE_KERNEL_INITRD_OFFSET
    hex "ARM Kernel INITRD start offset in kernel space"
    default 0x00400000
    help
        ARM Kernel INITRD start offset from the beginning of the Kernel address space.
        For Puma6 it must be 0x00400000

config ARM_AVALANCHE_KERNEL_PARAMS_OFFSET
    hex "ARM Kernel PARAMS start offset in kernel space"
    default 0x00000100
    help
        ARM Kernel PARAMS start offset from the beginning of the Kernel address space.
        For Puma6 it must be 0x100

config ARM_AVALANCHE_SDRAM_ADDRESS
    hex "(recalculated) ARM Kernel start address in SDRAM"
    default 0x80000000
	help
        ARM start address in SDRAM.
        For Puma5 it must be 0x80000000.
        This value is going to be recalculated by the external script

config ARM_AVALANCHE_KERNEL_ZRELADDR_ADDRESS
    hex "(recalculated) ARM Kernel ZRELADDR start address in SDRAM"
    default 0x80018000
	help
        ARM Kernel ZRELADDR start address in SDRAM.
        For Puma5 it must be ARM_AVALANCHE_SDRAM_ADDRESS + 0x18000
        This value is going to be recalculated by the external script

config ARM_AVALANCHE_KERNEL_INITRD_ADDRESS
    hex "(recalculated) ARM Kernel INITRD start address in SDRAM"
    default 0x80400000
	help
        ARM Kernel INITRD start address in SDRAM.
        For Puma5 it must be ARM_AVALANCHE_SDRAM_ADDRESS +  0x400000
        This value is going to be recalculated by the external script

config ARM_AVALANCHE_KERNEL_PARAMS_ADDRESS
    hex "(recalculated) ARM Kernel PARAMS start address in SDRAM"
    default 0x80000100
	help
        ARM Kernel PARAMS start address in SDRAM.
        For Puma5 it must be ARM_AVALANCHE_SDRAM_ADDRESS + 0x100
        This value is going to be recalculated by the external script
endmenu


config AVALANCHE_U_BOOT
        bool "Avalanche U-Boot support"
        default y
        help
          Choose y to build and use U-Boot bootloader.

config ARM_AVALANCHE_SPI
        bool "Avalanche SPI support"
        depends on SPI
        default y
        help
          Choose y to compile the Avalanche SPI driver.

config PSP_TRACE
        bool "PSP trace support"
        default y
        help
          choose y to compile psp trace support
		  
config ARM_AVALANCHE_CPGMAC_F
	tristate "Texas Instruments Avalanche CPGMAC support"       
    default m
    select AVALANCHE_LOW_CPMAC 
    help
        Choose y/m, to compile the TI Avalanche CPMAC driver.

config  ARM_CPMAC_PORTS 
	int 
	range 1 1
	default "1"

config  AVALANCHE_LOW_CPMAC 
    bool 

config  ARM_EXTERNAL_SWITCH
	bool	"External Switch Support"
	default n
	help
		Generic external switch framework
choice
	prompt "External Switch model"
	depends on ARM_EXTERNAL_SWITCH
	default ARM_AVALANCHE_ATHEROS_8328N
	help
      Select switch vendor and type.
config ARM_AVALANCHE_MARVELL_6063
	bool "The switch is MARVELL_6063"
config ARM_AVALANCHE_MARVELL_6060
	bool "The switch is MARVELL_6060"
config ARM_AVALANCHE_ATHEROS_8328N
	bool "The switch is ATHEROS 8328N"
endchoice
config ARM_CPMAC_DS_TRAFFIC_PRIORITY
        bool "Downstream Traffic Priority support"
        default y
        select TI_META_DATA
	help
          choose y enable Downstream Traffic Priority support

config ARM_AVALANCHE_PPD
    tristate "Texas Instruments Packet Processor Driver"
    default y
    help
        Choose y to compile in the packet processor driver for packet processing acceleration.

config ARM_AVALANCHE_PPD_TEST
    bool "Packet Processor Test"
    depends on ARM_AVALANCHE_PPD
    default y
    help
        Choose y to compile in the test support for packet processor driver.

config ARM_CPMAC_INIT_BUF_MALLOC
        bool "CPGMAC Init Buffer Malloc"
        depends on ARM_AVALANCHE_CPGMAC_F
        default n if MACH_PUMA5_VOLCANO


config ARM_AVALANCHE_USB20_OTG
    tristate "Texas Instruments Avalanche USB 2.0 OTG support"
    default n
    help
      Choose y/m, to compile the TI Avalanche USB 2.0 OTG driver.

config AVALANCHE_NUM_SER_PORTS
	depends on ARM_AVALANCHE_SOC
	int "Number of serial ports"
	default 2
	help
      Choose the correct number of serial ports on your soc here. If unsure
      consult the SoC specification from your vendor, but do not put a 
      wrong value here.

config AVALANCHE_CONSOLE_PORT
	depends on ARM_AVALANCHE_SOC
    int "Port number of the console"
	default 0 
	help
      Choose the Avalanche serial port number functioning as the ttyS0 (console)
      port. The valid values range from 0 through AVALANCHE_NUM_SER_PORTS - 1.

config ARM_AVALANCHE_VLYNQ
    bool "Texas Instruments VLYNQ (TM) bus support"
    default n 
    help
      Choose Y, to compile the TI VLYNQ (TM) bus support.

config ARM_AVALANCHE_VLYNQ_PORTS
    int
	depends on ARM_AVALANCHE_VLYNQ
    default 1
    help
      Define the number of VLYNQ (TM) ports on the board/SoC here.

config AVALANCHE_VLYNQ_POLARITY_LOW
	depends on ARM_AVALANCHE_VLYNQ
    bool
    default y
    help
      Define the number of VLYNQ (TM) ports on the board/SoC here.

config AVALANCHE_VLYNQ_CLK_LOCAL
	depends on ARM_AVALANCHE_VLYNQ
    default n
    bool
    help
      Define whether the VLYNQ (TM) clock is sourced locally or remotely.

config ARM_AVALANCHE_COLORED_LED
    bool "COLOR LED support"
    default y 
    help
      Choose Y, to compile the LED support.

config ARM_AVALANCHE_VLYNQ_PORTS
    int "Number of VLYNQ ports"
	depends on ARM_AVALANCHE_VLYNQ
    default 1
    help
      Define the number of VLYNQ (TM) ports on the board/SoC here.

config AVALANCHE_VLYNQ_POLARITY_LOW
	depends on ARM_AVALANCHE_VLYNQ
    default y
    help
      Define the number of VLYNQ (TM) ports on the board/SoC here.

config AVALANCHE_VLYNQ_CLK_LOCAL
	depends on ARM_AVALANCHE_VLYNQ
    default n
    help
      Define whether the VLYNQ (TM) clock is sourced locally or remotely.

endmenu
```

## arch/arm/mach-hsan/Kconfig
```kconfig
# define a global config variable

menu "HSAN platform feature"

config MACH_HSAN
	bool "HSAN platform"
	select CPU_V7
	select ARM_GIC
	select OUTER_CACHE
	select HAVE_SMP
	select HSAN
	help
	  Include support for the HSAN platform.
  
config HSAN_KCONSOLE
	int "Kernel console( 0 => UART0, 1 => UART1)"
	range 0 1
	default 0
	help
	  Select uart port as the default console used by kernel

config HSAN_KCONSOLE_BAUD
	int "Kernel console baud rate"
	default 115200
	help
	   Default uart port baud rate
	   
config HSAN_BUSCLK
	int "HSAN_BUSCLK"
	default "100000000"
	help
      	Default AHB clock rate

config HSAN_EDB
    bool "HSAN EDB"
    default n
    help
        used to early debug
        
menu "HSAN memory partition address"

config HSAN_PHYS_OFFSET
	hex "HSAN_PHYS_OFFSET"
	default "0x82000000"
	help    
        
config HSAN_ZRELADDR
	hex "HSAN_ZRELADDR"
	default "0x82008000"
	help    

config HSAN_PARAMS_PHYS
	hex "HSAN_PARAMS_PHYS"
	default "0x82000100"
	help

config HSAN_INITRD_PHYS
	hex "HSAN_INITRD_PHYS"
	default "0x82c00000"
	help      

endmenu
endmenu
```

## arch/arm/mach-spearbasic/Kconfig
```kconfig
menu "SPEAR platform options"
	depends on ARCH_SPEARBASIC
	

source "arch/arm/mach-spearbasic/Kconfig_Operation_Modes"

config SPEAR_MISC_CONFIG
	tristate "SPEAR Miscellaneous Register Configuration."
	default y
	help
	  The SPEAR Misc Config

#config SPEAR_LOCK
#	tristate "SPEAR Hw Lock"
#	default y
#	help
#	  The SPEAR Hw Lock

endmenu
```

## arch/arm/mach-spearplus/Kconfig
```kconfig
menu "SPEAR platform options"
	depends on ARCH_SPEARPLUS


config SPEAR_MISC_CONFIG
	tristate "SPEAR Miscellaneous Register Configuration."
	default y
	help
	  The SPEAR Misc Config

config SPEAR_LOCK
	tristate "SPEAR Hw Lock"
	default y
	help
	  The SPEAR Hw Lock

endmenu
```

## arch/arm/mach-sun5i/Kconfig
```kconfig
if ARCH_SUN5I

config SUN5I_FPGA
	bool "FPGA Board Support"
	help
	  Only for FPGA board. 

choice
        prompt "Chips Type"
        default SUN5I_A12

config SUN5I_A12
        bool "sun5i-a12"
        help
          sun5i-a12.

config SUN5I_A13
	bool "sun5i-a13"
	help
	  sun5i-a13.

endchoice

endif
```
